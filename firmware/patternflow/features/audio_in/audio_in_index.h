// ═══════════════════════════════════════════════════════════
// PatternFlow - /audio-in console page (PROGMEM HTML)
// License: MIT
// ═══════════════════════════════════════════════════════════
// The page body below is generated from console/audio-in.html — edit that,
// then run: python firmware/toolchain/console_pages.py build
#pragma once

#include <Arduino.h>

static const char AUDIO_IN_INDEX_HTML[] PROGMEM = R"HTML(<!doctype html>
<html lang="en">
<head>
<meta charset="utf-8">
<script src="/pf-console.js?h=efffd505"></script><script>if(!window.PF)(function(){var W=window,U='/api/status',L=[],M=2e9,S,Z,P=W.PF={state:'live',dirty:!1,v:null,get:G,inflight:Number,hold:Object,say:function(t,k,e){e&&(e.textContent=t)},busy:function(b,p){function f(){b.disabled=!1}b.disabled=!0;p.then(f,f);return p},poll:function(s,m,c,o){var t,f,g=1;function R(){g&&!f&&(f=1,clearTimeout(t),(s.call?s():G(s)).then(function(d){c(d,null)},function(e){c(null,e)}).then(K,K))}function K(){f=0;clearTimeout(t);g&&(t=setTimeout(R,m))}o&&o.first===!1?K():R();return{stop:function(){g=0;clearTimeout(t)},set:function(n){m=n;f||K()},now:R}},status:function(c){c&&L.push(c);S?c&&c(S):Z?Z.now():Z=P.poll(U,M,D)},watchStatus:function(m){P.status();Z.set(M=Math.min(m,M))},waitForDevice:function(o){o=o||{};return new Promise(function(y,n){var h=P.poll(U,2e3,function(s){s&&!(o.build&&s.build==o.build)&&(h.stop(),y(s))});setTimeout(function(){h.stop();n(Error('timeout'))},o.timeout||9e4)})}};function G(u,o){return fetch(u,o).then(function(r){if(!r.ok)throw Error(r.status);return o&&o.text?r.text():r.json()})}function D(s){if(s){S=W.pfStatus=s;L.forEach(function(f){f(s)})}}})()</script>
<meta name="viewport" content="width=device-width,initial-scale=1">
<title>Patternflow - Audio</title>
<!-- GENERATED by build_audio_in_page.py: edit its sources -->
<style>
*{box-sizing:border-box}
.page{max-width:1280px;margin:0 auto;padding:24px;display:flex;flex-direction:column;gap:14px}
.mono{font-family:var(--mono)}
.dimText{color:var(--muted)}
.hint{font-size:12px;color:var(--muted)}
.hint:empty{display:none}
.spacer{flex-grow:1}
.ghostBtn{font:inherit;font-size:11px;cursor:pointer;border:1px solid var(--rule);border-radius:2px;background:var(--field);color:var(--muted);padding:6px 12px}
.ghostBtn[aria-pressed=true]{border-color:var(--led);color:var(--ink)}
.ghostBtn.dan{color:var(--bad)}
.toolbar{display:flex;flex-wrap:wrap;align-items:center;gap:10px 14px}
#autoHint{flex:1 1 22em}
.glide{display:flex;flex-wrap:wrap;gap:10px 18px}
.damping{display:flex;align-items:center;gap:8px}
.damping input{width:130px;accent-color:var(--led)}
.damping .mono{font-size:11px;min-width:56px}
.toggleWrap{font:inherit;color:inherit;cursor:pointer;display:flex;align-items:center;gap:7px;border:1px solid var(--ink);border-radius:2px;background:var(--field);padding:5px 11px}
.toggleLabel{font-size:11px;font-weight:500}
.toggle{width:22px;height:12px;background:var(--rule);border-radius:7px;position:relative;flex:none;pointer-events:none}
.dotK{position:absolute;left:1px;top:1px;width:10px;height:10px;background:var(--field);border-radius:50%;transition:left 0.12s}
.toggleWrap.on .toggle{background:var(--ok)}
.toggleWrap.on .dotK{left:11px}
#muteToggle{align-self:flex-start}
.plotWrap{position:relative;isolation:isolate;background:var(--field);border:1px solid var(--rule);border-radius:2px;overflow:hidden}
#plot{display:block;cursor:default;width:100%;height:clamp(240px,45vh,400px)}
.tag canvas,.chipCard canvas{width:18px;height:12px}
.tag{position:absolute;display:flex;align-items:center;gap:6px;background:var(--cream-2);border:1px solid var(--rule);border-radius:2px;padding:2px 7px;pointer-events:none;white-space:nowrap}
.tag.sel{border-color:var(--led);z-index:1}
.tag.mutedTag{opacity:0.55}
.mutedTag canvas{display:none}
.tagText{font-family:var(--mono);font-size:10px}
.pv{position:absolute;inset:0;z-index:2;display:flex;flex-direction:column;background:var(--field)}
.pvHead{display:flex;flex-wrap:wrap;align-items:center;justify-content:space-between;gap:8px 14px;padding:10px 12px}
.pvChips{display:flex;flex-wrap:wrap;gap:8px}
.pvSig{font:inherit;font-size:11px;cursor:pointer;border:1px solid var(--rule);border-radius:2px;background:var(--field);color:var(--ink);padding:5px 11px}
.pvSig.on{border-color:var(--led);font-weight:600}
#pvScope{display:block;flex:1 1 0;min-height:0;width:100%}
.pvLegend{display:flex;gap:7px;align-items:center}
.pvKeyIn,.pvKeyOut{width:16px;height:3px;display:inline-block}
.pvKeyIn{background:var(--faint)}
.pvKeyOut{background:var(--led)}
.knobRow{display:flex;flex-wrap:wrap;align-items:center;gap:8px}
.chips{display:flex;gap:8px;flex:1 1 auto}
.chipCard{font:inherit;color:inherit;cursor:pointer;display:flex;align-items:center;gap:8px;background:var(--field);border:1px solid var(--rule);border-radius:2px;padding:7px 12px}
.chipCard.sel{border-color:var(--led)}
.chipCard.sel .chipName{font-weight:600}
.chipCard.mutedChip{opacity:0.55}
.chipDot{width:6px;height:6px;background:var(--led);border-radius:1px}
.chipCard .mono{font-size:11px}
.panel{display:flex;flex-wrap:wrap;gap:14px 20px;background:var(--field);border:1px solid var(--rule);border-radius:2px;padding:16px 18px}
.bandHead{flex:0 0 100%;display:flex;flex-wrap:wrap;align-items:baseline;gap:2px 8px}
.bandName{font-size:13px;font-weight:600;white-space:nowrap}
.col{display:flex;flex-direction:column;gap:8px;min-width:0}
.col.grow{flex:1 1 0;gap:12px}
.curveCol{flex:none}
.colKicker{font-family:var(--mono);font-size:10px;letter-spacing:0.09em;color:var(--muted)}
.vr{width:1px;background:var(--rule)}
.curveRow{display:flex;flex-wrap:wrap;gap:12px 20px}
#curve{display:block;flex:none;width:356px;max-width:100%;height:218px}
.presetsCol{width:268px;flex:none;display:flex;flex-direction:column;gap:8px}
.presetGrid{display:grid;grid-template-columns:repeat(3,minmax(0,1fr));gap:8px}
.preset{font:inherit;cursor:pointer;display:flex;flex-direction:column;align-items:center;gap:5px;border:1px solid var(--rule);border-radius:2px;background:var(--cream);padding:9px 4px 7px}
.preset canvas{width:40px;height:24px}
.preset span{font-size:10px;font-weight:500;color:var(--ink)}
.preset.on{border-color:var(--led)}
.preset.on span{font-weight:600}
.stepsRow{display:flex;align-items:center;gap:7px;font-size:11px;color:var(--muted)}
.stepsRow button{font:inherit;cursor:pointer;width:32px;height:32px;padding:0;line-height:1;border:1px solid var(--rule);border-radius:2px;background:var(--cream);color:var(--ink)}
.field{display:flex;flex-direction:column;gap:6px}
.fieldRow{display:flex;align-items:center;justify-content:space-between;gap:8px}
.fieldLabel{font-size:11px;color:var(--muted)}
.outTrack{position:relative;height:18px;cursor:pointer;touch-action:pan-y}
.outRail{position:absolute;left:5px;right:5px;top:50%;height:2px;margin-top:-1px;background:var(--rule)}
.outFill{position:absolute;top:50%;height:3px;margin-top:-1.5px;background:var(--led)}
.outHandle{position:absolute;top:50%;width:9px;height:10px;margin:-5px 0 0 -4.5px;background:var(--field);border:1px solid var(--ink)}
.outPresets{display:flex;flex-wrap:wrap;gap:6px}
.outPreset{font:inherit;font-size:10px;cursor:pointer;border:1px solid var(--rule);border-radius:2px;background:var(--cream);color:var(--muted);padding:3px 8px}
.acts{display:flex;flex-wrap:wrap;align-items:center;gap:8px}
#ed{display:contents}
#ed[inert] > *{opacity:0.5}
#ed[inert=inert] :is(.toggle,input,.outHandle,.hint){visibility:hidden}
@media (max-width:1100px){.vr{display:none}
.curveCol,.col.grow{flex:1 1 100%}
.presetsCol{flex:1 1 200px;width:auto}}
@media (max-width:700px){.page{padding:16px;gap:12px}
#plot{max-height:260px}
.panel{padding:14px 12px}
.glide,.damping{flex:1 1 100%}
.damping .fieldLabel{min-width:56px}
.damping input{flex:1;width:auto;min-width:0}
.chips{flex-basis:100%;gap:6px}
.chipCard{flex:1 1 0;min-width:0;flex-direction:column;gap:0;padding:6px 2px}
.chipDot,.chipCard canvas{display:none}
#openPreview{margin-left:auto}}
@media (pointer:coarse){.outTrack{height:36px}
.outHandle{width:16px;height:22px;margin:-11px 0 0 -8px}
.damping input{min-height:32px}
:is(.toggleWrap,.ghostBtn,.pvSig,.chipCard,.outPreset,.stepsRow button){position:relative}
:is(.toggleWrap,.ghostBtn,.pvSig,.chipCard,.outPreset,.stepsRow button)::after{content: "";position:absolute;inset:-8px -2px}}
:root{color-scheme:light;--cream:#F4EFE6;--panel:#FFFCFA;--ink:#1A1814;--muted:#625C51;--faint:#7D7668;--rule:#DDD5C6;--rule-soft:#E8E1D4;--ghost:#E3DCCE;--led:#FF5C2E;--bad:#B83C1C;--ok:#2B7A4B;--warn:#85600E;--sans:system-ui,-apple-system,'Segoe UI',Roboto,sans-serif;--mono:ui-monospace,'Cascadia Mono','SF Mono',Menlo,Consolas,'Roboto Mono',monospace;--field:var(--panel);--cream-2:var(--ghost)}
html[data-theme=dark]{color-scheme:dark;--cream:#0C0B09;--panel:#131110;--ink:#EDE7DB;--muted:#A39B8A;--faint:#7A7364;--rule:#2B2721;--rule-soft:#1F1C18;--ghost:#2A2620;--bad:#FF7A55;--ok:#57B87F;--warn:#D9A03F}
[hidden]{display:none!important}
body{margin:0;background:var(--cream);color:var(--ink);font:15px/1.5 var(--sans);-webkit-font-smoothing:antialiased}
a{color:inherit}:focus-visible{outline:2px solid var(--led);outline-offset:2px}
.wrap{max-width:1080px;margin:0 auto;padding:20px 16px 48px}
h2{margin:14px 0 0;font-size:13px;font-weight:600;color:var(--muted)}
.msg,.sub{font:12px var(--mono);color:var(--faint)}.pf-ok{color:var(--ok)}.pf-err{color:var(--bad)}
.chip{display:inline-block;padding:0 8px;border:1px solid var(--rule);border-radius:99px;font:11px/20px var(--mono);color:var(--muted);white-space:nowrap}
.chip.ok{border-color:var(--ok);color:var(--ok)}.chip.pf-err{border-color:var(--bad);color:var(--bad)}.chip:empty{display:none}
footer{display:flex;align-items:center;justify-content:space-between;gap:16px;margin-top:26px;border-top:1px solid var(--rule);font:12px var(--mono);color:var(--faint)}
footer a{display:inline-flex;align-items:center;min-height:40px;color:var(--muted);text-decoration:none}
header{display:flex;align-items:baseline;flex-wrap:wrap;gap:4px 12px}
h1{flex:1;margin:0;font-size:22px;font-weight:600;letter-spacing:-.01em}
p{margin:0}
.list{margin:0;padding:0;list-style:none;border-top:1px solid var(--rule)}
.list>li{display:flex;flex-wrap:wrap;align-items:center;gap:6px 10px;min-height:48px;padding:6px 0;border-bottom:1px solid var(--rule-soft)}
input[type=range]{accent-color:var(--ink)}
.ghostBtn,.pvSig,.toggleWrap{padding:0 12px}
.ghostBtn,.pvSig,.chipCard,.toggleWrap{min-height:32px;border-color:var(--rule);border-radius:8px;background:var(--panel);color:var(--ink);font:500 13px var(--sans);transition:border-color .15s}
.ghostBtn:hover,.outPreset:hover{border-color:var(--ink);color:var(--ink)}
.ghostBtn.dan,.ghostBtn.dan:hover{color:var(--bad)}.ghostBtn.dan:hover{border-color:var(--bad)}
:disabled{opacity:.45;cursor:default}
.toggleWrap{gap:8px;padding-left:8px}
.toggleLabel,.hint,.fieldLabel{font-size:13px}.fieldLabel{font-weight:500}
.toggle{width:28px;height:16px;border-radius:8px;background:var(--faint)}
.dotK{left:2px;top:2px;width:12px;height:12px}
.toggleWrap.on .toggle{background:var(--led)}.toggleWrap.on .dotK{left:14px}
.plotWrap,.panel{border-radius:10px}
.tag,.preset,.outPreset,.stepsRow button{border-radius:8px}
.mono,.tagText,.chipCard .mono,.damping .mono,.preset span,.outPreset,.stepsRow{font-size:12px}
.bandName{font-size:15px}
.colKicker{font:600 13px var(--sans);letter-spacing:0}
.outFill{background:var(--ink)}
.chipDot{display:none}
canvas{max-width:100%}
h2 .msg{margin-left:8px;font-weight:400}
.list .hint{flex:1 1 16em}
.pf-offline .plotWrap,.pf-offline .list,.pf-offline .sub{opacity:.5}
</style>
</head>
<body>
<main class="wrap page">
<header><h1>Audio</h1><span class="sub" id="st"></span></header>
<h2>Sources</h2>
<ul class="list">
<li>
<button id="micToggle" class="toggleWrap" disabled>
<span class="toggle"><span class="dotK"></span></span>
<span class="toggleLabel">Microphone</span>
</button>
<span id="micChip" class="chip"></span>
<span class="spacer"></span>
<div class="damping">
<label class="fieldLabel" for="micGain">Input gain</label>
<input id="micGain" type="range" min="1" max="16" step="0.5" disabled>
<span id="micGainVal" class="mono dimText"></span>
</div>
<p id="deviceNote" class="hint" style="flex-basis:100%"></p>
</li>
<li id="extRow">
<button id="audToggle" class="toggleWrap" disabled>
<span class="toggle"><span class="dotK"></span></span>
<span class="toggleLabel">Browser extension and phone app</span>
</button>
<span id="extChip" class="chip"></span>
<span class="hint">The extension brings its own mapping; the phone app uses the one below. Same switch as AUD on the panel’s NETWORK screen.
<a href="https://github.com/engmung/Patternflow/tree/main/tools/patternflow-audio-extension#readme" target="_blank">Get the extension</a></span>
</li>
</ul>
<h2>Mapping<span id="barMsg" class="msg" role="status"></span></h2>
<p class="hint">For the microphone and the phone app. Changes save to the panel as you make them.</p>
<div id="ed" inert="inert">
<div class="toolbar">
<button id="autoToggle" class="toggleWrap">
<span class="toggle"><span class="dotK"></span></span>
<span class="toggleLabel">Auto range</span>
</button>
<span id="autoHint" class="hint">Each box follows the loudness of what it hears. Drag a top or bottom edge to take all four over by hand.</span>
<div class="glide">
<div class="damping">
<label class="fieldLabel" for="attack">Attack</label>
<input id="attack" type="range" min="0" max="1" step="0.01">
<span id="attackWord" class="mono dimText"></span>
</div>
<div class="damping">
<label class="fieldLabel" for="damping">Damping</label>
<input id="damping" type="range" min="0" max="1" step="0.01">
<span id="dampingWord" class="mono dimText"></span>
</div>
</div>
</div>
<div id="plotWrap" class="plotWrap">
<canvas id="plot"></canvas>
<div class="tag" id="tag0"><span class="tagText">K1</span><canvas></canvas></div>
<div class="tag" id="tag1"><span class="tagText">K2</span><canvas></canvas></div>
<div class="tag" id="tag2"><span class="tagText">K3</span><canvas></canvas></div>
<div class="tag" id="tag3"><span class="tagText">K4</span><canvas></canvas></div>
<div id="pv" class="pv" hidden>
<div class="pvHead">
<div class="pvChips">
<button class="pvSig on" data-s="pulse">Kick pulses</button>
<button class="pvSig" data-s="noisy">Noisy room</button>
<button class="pvSig" data-s="swell">Slow swell</button>
</div>
<div class="pvLegend">
<span class="pvKeyIn"></span><span class="hint">test signal</span>
<span class="pvKeyOut"></span><span id="pvOut" class="hint">K1 output</span>
</div>
</div>
<canvas id="pvScope"></canvas>
</div>
</div>
<div class="knobRow">
<div class="chips">
<button class="chipCard" id="chip0"><span class="chipDot"></span><span class="chipName mono">K1</span><span class="chipHz mono dimText">&nbsp;</span><canvas></canvas></button>
<button class="chipCard" id="chip1"><span class="chipDot"></span><span class="chipName mono">K2</span><span class="chipHz mono dimText">&nbsp;</span><canvas></canvas></button>
<button class="chipCard" id="chip2"><span class="chipDot"></span><span class="chipName mono">K3</span><span class="chipHz mono dimText">&nbsp;</span><canvas></canvas></button>
<button class="chipCard" id="chip3"><span class="chipDot"></span><span class="chipName mono">K4</span><span class="chipHz mono dimText">&nbsp;</span><canvas></canvas></button>
</div>
<button id="openPreview" class="ghostBtn" aria-pressed="false"
title="Runs a test signal through this knob: its attack, damping, curve and output range">Preview</button>
</div>
<div class="panel">
<div class="bandHead">
<span id="bandName" class="bandName">Knob 1</span>
<span id="bandMeta" class="mono dimText"></span>
</div>
<div class="col curveCol">
<span class="colKicker">Response curve</span>
<div class="curveRow">
<canvas id="curve"></canvas>
<div class="presetsCol">
<div class="presetGrid">
<button class="preset" data-p="smooth"><canvas></canvas><span>Smooth</span></button>
<button class="preset" data-p="sharp"><canvas></canvas><span>Sharp</span></button>
<button class="preset" data-p="fall"><canvas></canvas><span>Fall</span></button>
<button class="preset" data-p="gate"><canvas></canvas><span>Gate</span></button>
<button class="preset" data-p="steps"><canvas></canvas><span>Steps</span></button>
<button class="preset" data-p="arch"><canvas></canvas><span>Arch</span></button>
</div>
<div id="stepsRow" class="stepsRow" hidden>
<span>Steps</span>
<button id="stepsMinus" aria-label="Fewer steps">&#8722;</button>
<span id="stepsN" class="mono">3</span>
<button id="stepsPlus" aria-label="More steps">+</button>
</div>
<span id="curveHint" class="hint"></span>
</div>
</div>
</div>
<div class="vr"></div>
<div class="col grow">
<div class="field">
<div class="fieldRow">
<span class="colKicker">Output range</span>
<span id="outLabel" class="mono"></span>
</div>
<div id="outTrack" class="outTrack">
<div class="outRail"></div>
<div id="outFill" class="outFill"></div>
<div id="outLo" class="outHandle"></div>
<div id="outHi" class="outHandle"></div>
</div>
<div class="outPresets">
<button class="outPreset" data-lo="0" data-hi="1">0&#8211;1</button>
<button class="outPreset" data-lo="0" data-hi="0.5">0&#8211;.5</button>
<button class="outPreset" data-lo="0.5" data-hi="1">.5&#8211;1</button>
<button class="outPreset" data-lo="0.25" data-hi="0.75">.25&#8211;.75</button>
<button class="outPreset" data-lo="0.15" data-hi="0.6">.15&#8211;.6</button>
<button class="outPreset" data-lo="0.3" data-hi="0.85">.3&#8211;.85</button>
</div>
</div>
<button id="muteToggle" class="toggleWrap">
<span class="toggle"><span class="dotK"></span></span>
<span class="toggleLabel">Mute</span>
</button>
</div>
</div>
<div class="acts">
<button id="resetBand" class="ghostBtn">Reset K1</button>
<button id="resetMap" class="ghostBtn dan" hidden>Reset mapping</button>
</div>
</div>
<footer><a href="/">Console</a><a href="/status">Status</a></footer>
</main>
<script>
var PFMap = (function () {
'use strict';
const within = (v, lo, hi) => Math.max(lo, Math.min(hi, Number(v) || 0));
const clamp01 = (v) => within(v, 0, 1);
const PRESETS = {
smooth: { type: 'bezier', id: 'smooth', y0: 0, y1: 1, p1x: 0.45, p1y: 0.05, p2x: 0.55, p2y: 0.95 },
sharp:  { type: 'bezier', id: 'sharp',  y0: 0, y1: 1, p1x: 0.10, p1y: 0.65, p2x: 0.35, p2y: 1.00 },
fall:   { type: 'bezier', id: 'fall',   y0: 1, y1: 0, p1x: 0.45, p1y: 0.95, p2x: 0.55, p2y: 0.05 },
gate:   { type: 'steps',  id: 'gate',  n: 2 },
steps:  { type: 'steps',  id: 'steps', n: 3 },
arch:   { type: 'arch',   id: 'arch' }
};
function evalCurve(curve, u) {
u = clamp01(u);
if (!curve) return u;
if (curve.type === 'steps') {
const n = within(Math.round(curve.n) || 2, 2, 8);
return Math.min(n - 1, Math.floor(u * n)) / (n - 1);
}
if (curve.type === 'arch') return Math.sin(Math.PI * u);
if (curve.type === 'bezier') {
const { y0 = 0, y1 = 1, p1x, p1y, p2x, p2y } = curve;
const bx = (t) => 3 * (1 - t) * (1 - t) * t * p1x + 3 * (1 - t) * t * t * p2x + t * t * t;
const by = (t) => (1 - t) * (1 - t) * (1 - t) * y0 + 3 * (1 - t) * (1 - t) * t * p1y + 3 * (1 - t) * t * t * p2y + t * t * t * y1;
let lo = 0, hi = 1;
for (let i = 0; i < 24; i++) {
const mid = (lo + hi) / 2;
if (bx(mid) < u) lo = mid; else hi = mid;
}
return clamp01(by((lo + hi) / 2));
}
return u;
}
function bakeLut(curve) {
const lut = [];
for (let i = 0; i <= 32; i++) lut.push(Number(evalCurve(curve, i / 32).toFixed(4)));
return lut;
}
const MIN_WINDOW = 0.02;
const MIN_OUT = 0.05;
const api = {
clamp01, PRESETS, evalCurve, bakeLut, MIN_WINDOW, MIN_OUT,
curveValue(band, u) {
return band.curve ? evalCurve(band.curve, u)
: Math.pow(clamp01(u), 1 / within(Number(band.gain) || 1, 0.2, 4));
},
position(level, band, env) {
if (env) {
return clamp01((clamp01((level - env.lo) / Math.max(0.001, env.hi - env.lo)) - 0.10) / (0.95 - 0.10));
}
const lo = clamp01(band.inMin);
return clamp01((level - lo) / Math.max(MIN_WINDOW, clamp01(band.inMax) - lo));
},
output(band, u) {
const lo = clamp01(band.outMin);
return lo + api.curveValue(band, u) * (clamp01(band.outMax) - lo);
},
defaultBand(index, caps) {
return normalizeBand(null, index, caps);
},
normalizeConfig(raw, caps) {
const stored = raw && Array.isArray(raw.bands) ? raw : { autoRange: true, bands: [] };
return {
autoRange: stored.autoRange === true,
smoothing: within(Number(stored.smoothing) || 0.35, 0.05, 0.9),
attack: within(Number(stored.attack) || 0.65, 0.05, 0.9),
bands: [0, 1, 2, 3].map((i) => normalizeBand(stored.bands[i], i, caps))
};
}
};
const HZ = [[60, 250], [250, 2000], [2000, 5000], [5000, 16000]];
function pair(lo, hi, floor, ceiling, gap) {
lo = within(lo, floor, ceiling);
hi = within(hi, floor, ceiling);
if (lo > hi) [lo, hi] = [hi, lo];
if (hi - lo < gap) {
hi = Math.min(ceiling, lo + gap);
lo = Math.min(lo, hi - gap);
}
return [lo, hi];
}
function normalizeBand(raw, index, caps) {
const b = raw && typeof raw === 'object' ? raw
: { outMin: 0.30, outMax: 0.85, curve: { ...PRESETS.smooth }, lut: bakeLut(PRESETS.smooth) };
const base = b.base ?? 0.30;
const [hzMin, hzMax] = pair(b.hzMin ?? HZ[index][0], b.hzMax ?? HZ[index][1], caps.hzMin, caps.hzMax, 10);
const [inMin, inMax] = pair(b.inMin ?? 0, b.inMax ?? 1, 0, 1, MIN_WINDOW);
const [outMin, outMax] = pair(b.outMin ?? base, b.outMax ?? base + (b.range ?? 0.55), 0, 1, MIN_OUT);
return {
hzMin, hzMax,
knob: index,
muted: b.muted === true,
inMin, inMax,
gain: within(Number(b.gain) || 1, 0.2, 4),
outMin, outMax,
curve: b.curve && typeof b.curve === 'object' ? b.curve : null,
lut: Array.isArray(b.lut) && b.lut.length > 1 ? b.lut : null
};
}
return api;
})();
</script>
<script>
(function () {
var DB_FLOOR = -45, DB_SPAN = 47;
var $ = (id) => document.getElementById(id);
var clamp01 = PFMap.clamp01;
var dbn = (x) => clamp01((20 * Math.log10(Math.max(Number(x) || 0, 1e-4)) - DB_FLOOR) / DB_SPAN);
var lin = (v) => Math.pow(10, (clamp01(v) * DB_SPAN + DB_FLOOR) / 20);
var say = (text, kind) => PF.say(text, kind || 'info', $('barMsg'));
function encodeMeta(curve) {
var c = curve || 0;
return c.type === 'steps' ? 's:' + c.n
: c.type === 'arch' ? 'a'
: c.type !== 'bezier' ? ''
: (PFMap.PRESETS[c.id] || 0).type === 'bezier' ? 'p:' + c.id
: 'b:' + [c.y0, c.y1, c.p1x, c.p1y, c.p2x, c.p2y].map((v) => Math.round(clamp01(v) * 100));
}
function decodeMeta(m) {
var q = m.slice(2).split(','), n = parseInt(q[0], 10) || 2, p = PFMap.PRESETS[q[0]] || 0;
q = q.map((v) => (parseInt(v, 10) || 0) / 100);
return m === 'a' ? { type: 'arch', id: 'arch' }
: /^s:/.test(m) ? { type: 'steps', id: n === 2 ? 'gate' : 'steps', n: Math.max(2, Math.min(8, n)) }
: /^p:/.test(m) && p.type === 'bezier' ? Object.assign({}, p)
: /^b:/.test(m) && q.length === 6 ? { type: 'bezier', id: 'custom', y0: q[0], y1: q[1], p1x: q[2], p1y: q[3], p2x: q[4], p2y: q[5] }
: null;
}
var ack = null, cur = {}, luts = [];
var hz = [31.25, 8000];
var frameFn, cfgFn, levels;
var tail = Promise.resolve();
var tries = 0, told = '', leaving = false;
var source = '', ext = false, micAt = 0;
var hasAud, aud = false, clients = 0, busy = 0;
var FIELDS = [['hzMin', 1], ['hzMax', 1], ['inMin', 5], ['inMax', 5], ['outMin', 3], ['outMax', 3], ['gain', 3]];
function ser(cfg, to) {
to.auto = cfg.autoRange ? '1' : '0';
to.smoothing = cfg.smoothing.toFixed(3);
to.attack = cfg.attack.toFixed(3);
cfg.bands.forEach((b, i) => {
FIELDS.forEach((f) => { to[f[0] + i] = (f[1] > 4 ? lin(b[f[0]]) : b[f[0]]).toFixed(f[1]); });
to['muted' + i] = b.muted ? '1' : '0';
to['meta' + i] = encodeMeta(b.curve);
luts[i] = (!b.curve ? [] : b.lut && b.lut.length === 33 ? b.lut : PFMap.bakeLut(b.curve))
.map((v) => Math.round(clamp01(v) * 255));
});
}
function diff(sent) {
var out = [];
var put = (k) => { out.push(k + '=' + encodeURIComponent(cur[k])); sent[k] = cur[k]; };
var one = (k, mate) => { if (cur[k] !== ack[k] || cur[mate] !== ack[mate]) put(k); };
['mic', 'auto', 'micGain', 'smoothing', 'attack'].forEach((k) => one(k));
for (let i = 0; i < 4; i++) {
FIELDS.forEach((f, n) => one(f[0] + i, n < 6 && FIELDS[n ^ 1][0] + i));
one('muted' + i);
if (cur['meta' + i] !== ack['meta' + i]) { put('meta' + i); out.push('lut' + i + '=' + luts[i]); }
}
return out.join('&');
}
var post = (url, body) => fetch(url, {
method: 'POST',
headers: { 'Content-Type': 'application/x-www-form-urlencoded' },
body: body, keepalive: leaving,
signal: AbortSignal.timeout ? AbortSignal.timeout(12000) : undefined
}).then((r) => {
if (!r.ok) throw Error(r.status);
return r.json();
});
function save() {
return tail = tail.then(() => {
var sent = {}, body = ack && diff(sent);
PF.dirty = !!body;
if (!body) return told && say(told = '');
return post('/api/audio-in', body).then(() => {
Object.assign(ack, sent);
if (sent.mic) { micAt = Date.now(); levels.set(100); levels.now(); }
if (told) say('saved', 'ok');
told = '';
tries = 0;
PF.dirty = !!diff({});
draw();
}, () => {
say(told = ++tries < 2 ? 'not saved yet: the panel did not answer. Trying again.'
: 'not saved: the panel did not take it. Change it again to retry.', 'err');
if (tries > 1) PF.say(told, 'err');
});
});
}
function change() { tries = 0; PF.dirty = true; return save(); }
function bye() {
var sent = {}, body = ack && diff(sent);
if (!body) return;
post('/api/audio-in', body).catch(() => {});
Object.assign(ack, sent);
}
addEventListener('pagehide', () => { leaving = true; bye(); });
addEventListener('pageshow', () => { leaving = false; });
function take(j) {
hz = j.hzRange || hz;
var cfg = PFMap.normalizeConfig({
autoRange: j.autoRange, smoothing: j.smoothing, attack: j.attack,
bands: j.bands.map((b) => Object.assign({}, b, {
inMin: dbn(b.inMin), inMax: dbn(b.inMax),
curve: b.lutSet ? decodeMeta(b.meta) : null
}))
}, { hzMin: hz[0], hzMax: hz[1] });
ack = {};
ser(cfg, ack);
ack.mic = j.micOn ? '1' : '0';
ack.micGain = j.micGain.toFixed(1);
cur = Object.assign({}, ack);
source = j.source;
PF.dirty = false;
$('micGain').value = ack.micGain;
$('micToggle').disabled = $('micGain').disabled = false;
draw();
return cfg;
}
function read() {
ack = null;
say('Reading the panel’s mapping…');
return new Promise((done) => {
var wait = 2000, rd = PF.poll('/api/audio-in', wait, (j) => {
if (j && (j.bands || 0).length === 4) {
rd.stop();
say('');
done(take(j));
} else {
say('Could not read the panel’s mapping. Trying again.', 'err');
rd.set(wait = Math.min(wait * 2, 16000));
}
});
});
}
function reset(body) {
return tail = tail.then(() => {
$('ed').inert = true;
return post('/api/audio-in/reset', body).then(read, () => {
say('Reset failed: the panel did not take it.', 'err');
}).then((cfg) => {
$('ed').inert = false;
return cfg;
});
});
}
function onLevels(j) {
var f = {}, conv;
if (!j) {
levels.set(1000);
frameFn(f);
return;
}
ext = j.ext;
source = j.source;
if (ack && cur.mic === ack.mic && Date.now() - micAt > 1500) cur.mic = ack.mic = ext || source === 'off' ? '0' : '1';
levels.set(ext ? 250 : source === 'pdm' || Date.now() - micAt < 1500 ? 100 : 1500);
if (ext || source === 'pdm') {
conv = ext ? clamp01 : dbn;
f.levels = j.levels.map(conv);
f.spectrum = j.spectrum.map(conv);
f.env = (j.env || []).map((e) => ext || e.lo >= 0 && e.hi > e.lo ? { lo: conv(e.lo), hi: conv(e.hi) } : null);
if (ext) {
f.db = [-80, -10];
} else if (ack) {
f.outputs = j.outputs;
f.pos = j.levels.map((v, i) => {
var lo = +ack['inMin' + i];
return clamp01(ack.auto > 0 ? (j.levelsN[i] - 0.10) / 0.85 : (v - lo) / (Math.max(lo + 0.01, ack['inMax' + i]) - lo));
});
}
}
draw();
frameFn(f);
if (tries === 1) save();
}
var NOTES = {
'off': 'The microphone is off. The mapping can still be edited.',
'not detected': 'No microphone found: the data pin (RX) is idle. Check the DAT lead.',
'not answering': 'The microphone is not answering.'
};
function flip(id, on) {
$(id).classList.toggle('on', on);
$(id).setAttribute('aria-pressed', on);
}
function chip(id, text, how) {
$(id).textContent = text;
$(id).className = 'chip' + how;
}
function draw() {
if (!ack) return;
var on = cur.mic > 0;
var m = !on ? 'off'
: Date.now() - micAt < 1500 || /^(off|phone)$/.test(source) ? 'starting'
: source === 'pdm' ? 'listening'
: source === 'pdm (no mic - data pin idle)' ? 'not detected'
: 'not answering';
var bad = /^not/.test(m) ? ' pf-err' : '', note = !ext && NOTES[m] || '';
flip('micToggle', on);
chip('micChip', m, bad || (m === 'listening' ? ' ok' : ''));
$('micGainVal').textContent = cur.micGain;
$('deviceNote').textContent = note;
$('deviceNote').className = 'hint' + bad;
$('plotWrap').style.opacity = bad ? 0.5 : '';
$('extRow').hidden = hasAud === false;
$('audToggle').disabled = !hasAud;
flip('audToggle', aud);
chip('extChip', !hasAud ? '' : !aud ? 'off' : ext ? 'phone app' : clients ? 'connected' : 'waiting', aud && ext ? ' ok' : '');
$('st').textContent = hasAud && aud && clients && !ext ? 'a browser or phone is connected'
: (m === 'listening' ? 'the microphone' : ext ? 'the phone app' : 'nothing') + ' has the knobs';
}
function onStatus(s) {
hasAud = (s.caps || []).includes('audio');
if (!busy) aud = s.audioRuntime;
clients = s.audioClients;
draw();
}
$('micToggle').onclick = () => {
cur.mic = cur.mic > 0 ? '0' : '1';
micAt = Date.now();
draw();
change();
};
$('micGain').oninput = () => {
cur.micGain = (+$('micGain').value).toFixed(1);
PF.dirty = true;
draw();
};
$('micGain').onchange = change;
$('audToggle').onclick = () => {
var want = aud = !aud;
busy++;
draw();
tail = tail.then(() => post('/api/audio', 'on=' + (want ? 1 : 0)).then((r) => {
aud = r.audioRuntime;
}, () => {
aud = !want;
say('not switched: the panel did not answer.', 'err');
}).then(() => {
busy--;
draw();
}));
};
new MutationObserver(() => { if (frameFn) selectBand(sel); })
.observe(document.documentElement, { attributeFilter: ['data-theme'] });
window.PFAdapter = {
loadConfig: read,
caps: () => ({
hzMin: hz[0], hzMax: hz[1], hzGap: 31.25,
db: [DB_FLOOR, DB_FLOOR + DB_SPAN],
levelMax: dbn(1),
top: (lo) => Math.max(lo + PFMap.MIN_WINDOW, dbn(lin(lo) + 0.01)),
bottom: (hi) => Math.min(hi - PFMap.MIN_WINDOW, dbn(lin(hi) - 0.01))
}),
saveConfig: (cfg) => {
if (!ack) return;
ser(cfg, cur);
return leaving ? bye() : change();
},
onConfig: (fn) => { cfgFn = fn; },
onFrame: (fn) => {
frameFn = fn;
levels = PF.poll('/api/audio-in?levels=1', 100, onLevels);
PF.status(onStatus);
PF.watchStatus(5000);
},
resetBand: (i) => reset('band=' + i),
resetAll: (button) => {
if (PFConfirm(button, 'Press again: resets all four knobs, their curves, attack, damping and input gain')) {
PF.busy(button, reset('').then((cfg) => { if (cfg) cfgFn(cfg); }));
}
}
};
})();
</script>
<script>
'use strict';
const A = window.PFAdapter;
const { clamp01, PRESETS, evalCurve, bakeLut } = PFMap;
let CAPS = null;
let DECADES = 1;
let TICKS = [];
function readCaps() {
const c = A.caps();
CAPS = {
hzMin: c.hzMin, hzMax: c.hzMax,
db: c.db || null,
levelMax: c.levelMax || 1,
hzGap: c.hzGap || 0,
top: c.top || ((lo) => lo + PFMap.MIN_WINDOW),
bottom: c.bottom || ((hi) => hi - PFMap.MIN_WINDOW)
};
DECADES = Math.log10(CAPS.hzMax / CAPS.hzMin);
TICKS = [[50, '50'], [100, '100'], [200, '200'], [500, '500'],
[1000, '1k'], [2000, '2k'], [5000, '5k'], [10000, '10k']]
.filter(([hz]) => hz > CAPS.hzMin * 1.15 && hz < CAPS.hzMax * 0.87);
}
const clampHz = (v) => Math.max(CAPS.hzMin, Math.min(CAPS.hzMax, Number(v) || CAPS.hzMin));
function bandCurveValue(band, u) {
return band.curve ? evalCurve(band.curve, u) : PFMap.curveValue(band, u);
}
let cfg = null;
let sel = 0;
let frame = {};
let saveTimer = 0;
function persist() {
clearTimeout(saveTimer);
saveTimer = setTimeout(flush, 150);
}
function flush() {
if (!saveTimer) return null;
clearTimeout(saveTimer);
saveTimer = 0;
return A.saveConfig(cfg);
}
window.addEventListener('pagehide', flush);
function applyConfig(raw) {
cfg = PFMap.normalizeConfig(raw, CAPS);
syncAutoToggle();
syncDamping();
selectBand(sel);
}
function touchCurve(band, curve) {
band.curve = curve;
band.lut = bakeLut(curve);
}
const $ = (id) => document.getElementById(id);
const plotCanvas = $('plot');
const pctx = plotCanvas.getContext('2d');
const M = { l: 48, r: 6, t: 26, b: 40 };
let PW = 0, PH = 0;
const COARSE = matchMedia('(pointer: coarse)').matches;
const EDGE = COARSE ? 18 : 7;
const GRIP = COARSE ? 11 : 7;
const REACH = COARSE ? 22 : 12;
const HINT_AUTO = 'Each box follows the loudness of what it hears. '
+ (COARSE ? 'Switch Auto range off to set a height by hand.' : 'Drag a top or bottom edge to take all four over by hand.');
const HINT_HAND = 'Width: the frequencies a knob listens to. Height: the quiet-to-loud range mapped onto it.';
function sizePlot() {
plotCanvas.style.height = '';
const cssW = plotCanvas.clientWidth, cssH = plotCanvas.clientHeight;
const dpr = window.devicePixelRatio || 1;
plotCanvas.width = Math.round(cssW * dpr);
plotCanvas.height = Math.round(cssH * dpr);
plotCanvas.style.height = cssH + 'px';
pctx.setTransform(dpr, 0, 0, dpr, 0, 0);
PW = cssW - M.l - M.r;
PH = cssH - M.t - M.b;
}
const xOf = (hz) => M.l + PW * (Math.log10(clampHz(hz) / CAPS.hzMin) / DECADES);
const hzOf = (x) => clampHz(CAPS.hzMin * Math.pow(10, DECADES * ((x - M.l) / PW)));
const yOf = (v) => M.t + (1 - clamp01(v)) * PH;
const vOf = (y) => clamp01(1 - (y - M.t) / PH);
const axisDb = () => frame.db || CAPS.db;
const minus = (n) => String(Math.round(n)).replace('-', '−');
function dbText(v) {
const db = axisDb();
return db ? minus(db[0] + v * (db[1] - db[0])) : '';
}
function dbLines() {
const db = axisDb();
const lines = [];
if (!db) return lines;
for (let d = Math.ceil(db[0] / 10) * 10; d <= db[1]; d += 10) {
lines.push([(d - db[0]) / (db[1] - db[0]), minus(d)]);
}
return lines;
}
function theme() {
const s = getComputedStyle(document.body);
const v = (name) => s.getPropertyValue(name).trim();
const alpha = (name) => {
const n = parseInt(v(name).slice(1), 16);
return (a) => `rgba(${n >> 16}, ${n >> 8 & 255}, ${n & 255}, ${a})`;
};
return {
field: v('--field'),
cream: v('--cream'),
ink: v('--ink'),
muted: v('--muted'),
faint: v('--faint'),
rule: v('--rule'),
led: v('--led'),
ledA: alpha('--led'),
ruleA: alpha('--rule'),
inkA: alpha('--ink')
};
}
function liveEnv(index) {
const env = cfg.autoRange && frame.env && frame.env[index];
return env && env.hi > env.lo ? { lo: clamp01(env.lo), hi: clamp01(env.hi) } : null;
}
function bandWindow(index) {
const band = cfg.bands[index];
return liveEnv(index) || { lo: band.inMin, hi: band.inMax };
}
const hearing = () => !!(frame.levels && frame.levels.length);
function bandPos(index) {
if (frame.pos && frame.pos.length) return clamp01(frame.pos[index]);
return PFMap.position(frame.levels[index] || 0, cfg.bands[index], liveEnv(index));
}
function fitWindow(band) {
band.inMin = Math.max(0, Math.min(band.inMin, CAPS.bottom(CAPS.levelMax)));
band.inMax = Math.min(CAPS.levelMax, Math.max(band.inMax, CAPS.top(band.inMin)));
}
function formatHz(hz) {
return hz >= 1000 ? (hz / 1000).toFixed(hz >= 9950 ? 0 : 1).replace(/\.0$/, '') + 'k' : String(Math.round(hz));
}
const MONO = '11px ui-monospace, SFMono-Regular, Menlo, Consolas, monospace';
function drawPlot() {
const T = theme();
const W = M.l + PW + M.r, H = M.t + PH + M.b;
pctx.clearRect(0, 0, W, H);
pctx.fillStyle = T.field;
pctx.fillRect(0, 0, W, H);
pctx.font = MONO;
pctx.strokeStyle = T.ruleA(0.55);
pctx.fillStyle = T.muted;
pctx.lineWidth = 1;
for (const [v, label] of dbLines()) {
const y = Math.round(yOf(v)) + 0.5;
if (v > 0 && v < 1) {
pctx.beginPath(); pctx.moveTo(M.l, y); pctx.lineTo(M.l + PW, y); pctx.stroke();
}
pctx.textAlign = 'right';
pctx.fillText(label, M.l - 8, y + 3);
}
pctx.textAlign = 'right';
if (axisDb()) pctx.fillText('dB', M.l - 8, M.t - 9);
pctx.fillText('Hz', M.l - 8, M.t + PH + 16);
pctx.textAlign = 'center';
for (const [hz, label] of TICKS) {
const x = Math.round(xOf(hz)) + 0.5;
pctx.beginPath(); pctx.moveTo(x, M.t); pctx.lineTo(x, M.t + PH); pctx.stroke();
pctx.fillText(label, x, M.t + PH + 16);
}
pctx.textAlign = 'left';
pctx.fillText(formatHz(CAPS.hzMin), M.l, M.t + PH + 16);
pctx.textAlign = 'right';
pctx.fillText(formatHz(CAPS.hzMax), M.l + PW, M.t + PH + 16);
pctx.strokeStyle = T.rule;
pctx.beginPath(); pctx.moveTo(M.l, M.t + PH + 0.5); pctx.lineTo(M.l + PW, M.t + PH + 0.5); pctx.stroke();
const spec = frame.spectrum || [];
if (spec.length > 1) {
pctx.fillStyle = T.inkA(0.14);
pctx.beginPath();
pctx.moveTo(M.l, yOf(spec[0]));
const bw = PW / spec.length;
for (let i = 0; i < spec.length; i++) {
const y = yOf(spec[i]);
pctx.lineTo(M.l + i * bw, y);
pctx.lineTo(M.l + (i + 1) * bw, y);
}
pctx.lineTo(M.l + PW, M.t + PH);
pctx.lineTo(M.l, M.t + PH);
pctx.closePath();
pctx.fill();
}
cfg.bands.forEach((band, i) => {
const win = bandWindow(i);
const x0 = xOf(band.hzMin), x1 = xOf(band.hzMax);
const yTop = yOf(win.hi), yBot = yOf(win.lo);
const isSel = i === sel;
const stroke = isSel ? T.led : (band.muted ? T.faint : T.ink);
const alpha = band.muted ? 0.04 : (isSel ? 0.12 : 0.07);
pctx.fillStyle = T.ledA(alpha);
pctx.fillRect(x0, yTop, x1 - x0, yBot - yTop);
pctx.strokeStyle = stroke;
pctx.lineWidth = isSel ? 1.5 : 1;
pctx.beginPath(); pctx.moveTo(x0, yTop); pctx.lineTo(x0, yBot); pctx.stroke();
pctx.beginPath(); pctx.moveTo(x1, yTop); pctx.lineTo(x1, yBot); pctx.stroke();
if (cfg.autoRange) pctx.setLineDash([5, 4]);
pctx.beginPath(); pctx.moveTo(x0, yTop); pctx.lineTo(x1, yTop); pctx.stroke();
pctx.beginPath(); pctx.moveTo(x0, yBot); pctx.lineTo(x1, yBot); pctx.stroke();
pctx.setLineDash([]);
if (hearing()) {
const ly = Math.max(yTop + 1.5, Math.min(yBot - 1.5, yBot - bandPos(i) * (yBot - yTop)));
pctx.strokeStyle = T.led;
pctx.lineWidth = 2;
pctx.beginPath();
pctx.moveTo(x0 + 1, ly);
pctx.lineTo(x1 - 1, ly);
pctx.stroke();
}
if (isSel) {
pctx.fillStyle = T.field;
pctx.strokeStyle = T.ink;
pctx.lineWidth = 1;
for (const [cx, cy] of [[x0, yTop], [x1, yTop], [x0, yBot], [x1, yBot]]) {
pctx.fillRect(cx - GRIP / 2, cy - GRIP / 2, GRIP, GRIP);
pctx.strokeRect(cx - GRIP / 2, cy - GRIP / 2, GRIP, GRIP);
}
}
});
placeTags();
}
function placeTags() {
const T = theme();
cfg.bands.forEach((band, i) => {
const tag = $('tag' + i);
const win = bandWindow(i);
tag.classList.toggle('sel', i === sel);
tag.classList.toggle('mutedTag', band.muted);
tag.querySelector('.tagText').textContent = 'K' + (i + 1) + (band.muted ? ' muted' : '');
drawGlyph(tag.querySelector('canvas'), band, 18, 12, T.ink);
tag.style.left = Math.round(Math.min(xOf(band.hzMin), M.l + PW + M.r - tag.offsetWidth - 1)) + 'px';
tag.style.top = Math.round(yOf(win.hi) - 21) + 'px';
});
}
function drawGlyph(canvas, band, w, h, color) {
const dpr = window.devicePixelRatio || 1;
if (canvas.width !== w * dpr) {
canvas.width = w * dpr; canvas.height = h * dpr;
}
const g = canvas.getContext('2d');
g.setTransform(dpr, 0, 0, dpr, 0, 0);
g.clearRect(0, 0, w, h);
g.strokeStyle = color;
g.lineWidth = 1.4;
g.lineCap = 'round';
g.beginPath();
for (let i = 0; i <= 16; i++) {
const u = i / 16;
const v = bandCurveValue(band, u);
const x = 2 + u * (w - 4);
const y = h - 2 - v * (h - 4);
if (i === 0) g.moveTo(x, y); else g.lineTo(x, y);
}
g.stroke();
}
let drag = null;
function hitTest(x, y) {
const order = [sel, ...cfg.bands.map((_, i) => i).filter((i) => i !== sel)];
for (const i of order) {
const band = cfg.bands[i];
const win = bandWindow(i);
const x0 = xOf(band.hzMin), x1 = xOf(band.hzMax);
const yTop = yOf(win.hi), yBot = yOf(win.lo);
const insideX = x > x0 - EDGE && x < x1 + EDGE;
const insideY = y > yTop - EDGE && y < yBot + EDGE;
if (!insideX || !insideY) continue;
const inX = Math.min(EDGE, (x1 - x0) / 3), inY = Math.min(EDGE, (yBot - yTop) / 3);
const nearL = x <= x0 + inX, nearR = x >= x1 - inX;
const tall = !(COARSE && cfg.autoRange);
const nearT = tall && y <= yTop + inY, nearB = tall && y >= yBot - inY;
if (nearL && nearT) return { band: i, mode: 'tl' };
if (nearR && nearT) return { band: i, mode: 'tr' };
if (nearL && nearB) return { band: i, mode: 'bl' };
if (nearR && nearB) return { band: i, mode: 'br' };
if (nearL) return { band: i, mode: 'l' };
if (nearR) return { band: i, mode: 'r' };
if (nearT) return { band: i, mode: 't' };
if (nearB) return { band: i, mode: 'b' };
if (x > x0 && x < x1 && y > yTop && y < yBot) return { band: i, mode: 'move' };
}
return null;
}
function takeOver() {
cfg.bands.forEach((band, i) => {
const env = liveEnv(i);
if (!env) return;
band.inMin = env.lo;
band.inMax = env.hi;
fitWindow(band);
});
cfg.autoRange = false;
syncAutoToggle();
}
function plotPointer(event) {
const rect = plotCanvas.getBoundingClientRect();
return { x: event.clientX - rect.left, y: event.clientY - rect.top };
}
function dragOnHit(canvas, hits) {
canvas.addEventListener('touchstart', (event) => {
const rect = canvas.getBoundingClientRect();
const touch = event.changedTouches[0];
if (hits(touch.clientX - rect.left, touch.clientY - rect.top)) event.preventDefault();
}, { passive: false });
}
dragOnHit(plotCanvas, hitTest);
plotCanvas.addEventListener('pointerdown', (event) => {
const { x, y } = plotPointer(event);
const hit = hitTest(x, y);
if (!hit) return;
if (hit.band !== sel) selectBand(hit.band);
drag = { ...hit, startX: x, startY: y, live: false };
plotCanvas.setPointerCapture(event.pointerId);
event.preventDefault();
});
const SLOP = 4;
plotCanvas.addEventListener('pointermove', (event) => {
const { x, y } = plotPointer(event);
if (!drag) {
const hit = hitTest(x, y);
plotCanvas.style.cursor = !hit ? 'default'
: hit.mode === 'move' ? 'move'
: (hit.mode === 'tl' || hit.mode === 'br') ? 'nwse-resize'
: (hit.mode === 'tr' || hit.mode === 'bl') ? 'nesw-resize'
: (hit.mode === 'l' || hit.mode === 'r') ? 'ew-resize' : 'ns-resize';
return;
}
const band = cfg.bands[drag.band];
if (!drag.live) {
if (Math.hypot(x - drag.startX, y - drag.startY) < SLOP) return;
if (cfg.autoRange && /[tb]/.test(drag.mode)) takeOver();
const win = bandWindow(drag.band);
Object.assign(drag, { live: true, hzMin: band.hzMin, hzMax: band.hzMax, lo: win.lo, hi: win.hi });
}
const MINR = 1.12;
if (drag.mode === 'move') {
const shift = (x - drag.startX) / PW * DECADES;
let ratio = Math.pow(10, shift);
ratio = Math.max(CAPS.hzMin / drag.hzMin, Math.min(CAPS.hzMax / drag.hzMax, ratio));
band.hzMin = drag.hzMin * ratio;
band.hzMax = Math.max(drag.hzMax * ratio, band.hzMin + CAPS.hzGap);
if (!cfg.autoRange) {
const dv = vOf(y) - vOf(drag.startY);
const span = drag.hi - drag.lo;
band.inMin = Math.max(0, Math.min(CAPS.levelMax - span, drag.lo + dv));
band.inMax = band.inMin + span;
fitWindow(band);
}
} else {
if (drag.mode.includes('l')) band.hzMin = Math.max(CAPS.hzMin, Math.min(hzOf(x), band.hzMax / MINR, band.hzMax - CAPS.hzGap));
if (drag.mode.includes('r')) band.hzMax = Math.min(CAPS.hzMax, Math.max(hzOf(x), band.hzMin * MINR, band.hzMin + CAPS.hzGap));
if (drag.mode.includes('t')) band.inMax = Math.min(CAPS.levelMax, Math.max(vOf(y), CAPS.top(band.inMin)));
if (drag.mode.includes('b')) band.inMin = Math.max(0, Math.min(vOf(y), CAPS.bottom(band.inMax)));
}
drawPlot();
drawCurve();
renderChips();
renderSettings();
});
const releasePlot = () => {
if (!drag) return;
const moved = drag.live;
drag = null;
if (moved) persist();
};
plotCanvas.addEventListener('pointerup', releasePlot);
plotCanvas.addEventListener('pointercancel', releasePlot);
const curveCanvas = $('curve');
const cctx = curveCanvas.getContext('2d');
const CM = { l: 34, r: 10, t: 12, b: 26 };
let CW = 0, CH = 0;
let curveDrag = null;
function sizeCurve() {
const dpr = window.devicePixelRatio || 1;
const cssW = curveCanvas.clientWidth, cssH = 218;
curveCanvas.width = cssW * dpr; curveCanvas.height = cssH * dpr;
cctx.setTransform(dpr, 0, 0, dpr, 0, 0);
CW = cssW - CM.l - CM.r; CH = cssH - CM.t - CM.b;
}
const cxOf = (u) => CM.l + clamp01(u) * CW;
const cyOf = (v) => CM.t + (1 - clamp01(v)) * CH;
function drawCurve() {
const T = theme();
const band = cfg.bands[sel];
const W = CM.l + CW + CM.r, H = CM.t + CH + CM.b;
cctx.clearRect(0, 0, W, H);
cctx.fillStyle = T.cream;
cctx.fillRect(CM.l, CM.t, CW, CH);
cctx.strokeStyle = T.rule;
cctx.lineWidth = 1;
cctx.strokeRect(CM.l + 0.5, CM.t + 0.5, CW - 1, CH - 1);
cctx.strokeStyle = T.ruleA(0.5);
cctx.beginPath(); cctx.moveTo(cxOf(0.5), CM.t); cctx.lineTo(cxOf(0.5), CM.t + CH); cctx.stroke();
cctx.beginPath(); cctx.moveTo(CM.l, cyOf(0.5)); cctx.lineTo(CM.l + CW, cyOf(0.5)); cctx.stroke();
cctx.strokeStyle = T.ink;
cctx.lineWidth = 2;
cctx.lineCap = 'round';
cctx.beginPath();
const steps = band.curve && band.curve.type === 'steps';
const N = steps ? 200 : 64;
for (let i = 0; i <= N; i++) {
const u = i / N;
const v = bandCurveValue(band, u);
const x = cxOf(u), y = cyOf(v);
if (i === 0) cctx.moveTo(x, y); else cctx.lineTo(x, y);
}
cctx.stroke();
if (band.curve && band.curve.type === 'bezier') {
const c = band.curve;
cctx.strokeStyle = T.faint;
cctx.setLineDash([2, 3]);
cctx.beginPath(); cctx.moveTo(cxOf(0), cyOf(c.y0)); cctx.lineTo(cxOf(c.p1x), cyOf(c.p1y)); cctx.stroke();
cctx.beginPath(); cctx.moveTo(cxOf(1), cyOf(c.y1)); cctx.lineTo(cxOf(c.p2x), cyOf(c.p2y)); cctx.stroke();
cctx.setLineDash([]);
cctx.fillStyle = T.led;
cctx.strokeStyle = T.ink;
cctx.lineWidth = 1;
for (const [hx, hy] of [[c.p1x, c.p1y], [c.p2x, c.p2y]]) {
cctx.fillRect(cxOf(hx) - GRIP / 2, cyOf(hy) - GRIP / 2, GRIP, GRIP);
cctx.strokeRect(cxOf(hx) - GRIP / 2, cyOf(hy) - GRIP / 2, GRIP, GRIP);
}
}
const win = bandWindow(sel);
if (hearing()) {
const u = bandPos(sel);
const v = bandCurveValue(band, u);
cctx.strokeStyle = T.led;
cctx.setLineDash([3, 3]);
cctx.lineWidth = 1;
cctx.beginPath(); cctx.moveTo(cxOf(u), CM.t + CH); cctx.lineTo(cxOf(u), cyOf(v)); cctx.stroke();
cctx.setLineDash([]);
cctx.fillStyle = T.led;
cctx.beginPath(); cctx.arc(cxOf(u), cyOf(v), 4.5, 0, Math.PI * 2); cctx.fill();
const out = frame.outputs && frame.outputs.length ? frame.outputs[sel] : PFMap.output(band, u);
const heard = dbText(frame.levels[sel] || 0);
cctx.font = MONO;
cctx.fillStyle = T.muted;
cctx.textAlign = 'left';
cctx.fillText((heard && heard + ' dB ') + '→ ' + Number(out).toFixed(2), CM.l + 6, CM.t + 12);
}
const lo = dbText(win.lo);
cctx.font = MONO;
cctx.fillStyle = T.muted;
cctx.textAlign = 'left';
cctx.fillText(cfg.autoRange ? 'auto range' : lo, CM.l, CM.t + CH + 16);
cctx.textAlign = 'right';
cctx.fillText(cfg.autoRange || !lo ? '' : dbText(win.hi) + ' dB', CM.l + CW, CM.t + CH + 16);
cctx.fillText(band.outMax.toFixed(2), CM.l - 6, CM.t + 8);
cctx.fillText(band.outMin.toFixed(2), CM.l - 6, CM.t + CH);
}
function curveHit(x, y) {
const c = cfg.bands[sel].curve;
if (!c || c.type !== 'bezier') return null;
const near = (hx, hy) => Math.hypot(x - cxOf(hx), y - cyOf(hy)) < REACH;
return near(c.p1x, c.p1y) ? 'p1' : near(c.p2x, c.p2y) ? 'p2' : null;
}
dragOnHit(curveCanvas, curveHit);
curveCanvas.addEventListener('pointerdown', (event) => {
const rect = curveCanvas.getBoundingClientRect();
curveDrag = curveHit(event.clientX - rect.left, event.clientY - rect.top);
if (!curveDrag) return;
curveCanvas.setPointerCapture(event.pointerId);
event.preventDefault();
});
curveCanvas.addEventListener('pointermove', (event) => {
if (!curveDrag) return;
const rect = curveCanvas.getBoundingClientRect();
const u = clamp01((event.clientX - rect.left - CM.l) / CW);
const v = clamp01(1 - (event.clientY - rect.top - CM.t) / CH);
const band = cfg.bands[sel];
const c = band.curve;
if (curveDrag === 'p1') { c.p1x = u; c.p1y = v; }
else { c.p2x = u; c.p2y = v; }
c.id = 'custom';
band.lut = bakeLut(c);
drawCurve();
renderPresetChips();
placeTags();
});
const releaseCurve = () => {
if (!curveDrag) return;
curveDrag = null;
persist();
renderChips();
};
curveCanvas.addEventListener('pointerup', releaseCurve);
curveCanvas.addEventListener('pointercancel', releaseCurve);
function renderPresetChips() {
const band = cfg.bands[sel];
const id = band.curve ? (band.curve.id || 'custom') : null;
document.querySelectorAll('.preset').forEach((el) => {
el.classList.toggle('on', el.dataset.p === id);
el.setAttribute('aria-pressed', el.dataset.p === id);
});
$('curveHint').textContent = !band.curve ? 'This knob uses the default response.'
: band.curve.type === 'bezier' ? 'Drag the two handles for a custom shape.' : '';
$('stepsRow').hidden = !(band.curve && band.curve.type === 'steps');
if (band.curve && band.curve.type === 'steps') $('stepsN').textContent = String(band.curve.n);
document.querySelectorAll('.preset canvas').forEach((canvas) => {
const preset = PRESETS[canvas.parentElement.dataset.p];
drawGlyph(canvas, { curve: preset, gain: 1 }, 40, 24, theme().ink);
});
}
document.querySelectorAll('.preset').forEach((el) => {
el.addEventListener('click', () => {
const preset = PRESETS[el.dataset.p];
if (!preset) return;
touchCurve(cfg.bands[sel], structuredClone(preset));
drawCurve();
renderPresetChips();
placeTags();
renderChips();
persist();
});
});
$('stepsMinus').addEventListener('click', () => stepsAdjust(-1));
$('stepsPlus').addEventListener('click', () => stepsAdjust(1));
function stepsAdjust(delta) {
const band = cfg.bands[sel];
if (!band.curve || band.curve.type !== 'steps') return;
band.curve.n = Math.max(2, Math.min(8, band.curve.n + delta));
band.curve.id = band.curve.n === 2 ? 'gate' : 'steps';
band.lut = bakeLut(band.curve);
drawCurve();
renderPresetChips();
placeTags();
renderChips();
persist();
}
function renderSettings() {
const band = cfg.bands[sel];
const lo = dbText(band.inMin);
$('bandName').textContent = 'Knob ' + (sel + 1);
$('bandMeta').textContent = formatHz(band.hzMin) + ' – ' + formatHz(band.hzMax) + ' Hz'
+ (cfg.autoRange ? ' · auto range' : lo && ' · ' + lo + ' to ' + dbText(band.inMax) + ' dB');
$('outLabel').textContent = band.outMin.toFixed(2) + ' – ' + band.outMax.toFixed(2);
const w = $('outTrack').clientWidth - 10;
$('outLo').style.left = (5 + band.outMin * w) + 'px';
$('outHi').style.left = (5 + band.outMax * w) + 'px';
$('outFill').style.left = (5 + band.outMin * w) + 'px';
$('outFill').style.width = Math.max(0, (band.outMax - band.outMin) * w) + 'px';
$('muteToggle').classList.toggle('on', band.muted);
$('muteToggle').setAttribute('aria-pressed', band.muted);
$('resetBand').textContent = 'Reset K' + (sel + 1);
$('pvOut').textContent = 'K' + (sel + 1) + ' output';
}
document.querySelectorAll('.outPreset').forEach((el) => {
el.addEventListener('click', () => {
const band = cfg.bands[sel];
band.outMin = Number(el.dataset.lo);
band.outMax = Number(el.dataset.hi);
renderSettings(); drawCurve(); renderChips(); persist();
});
});
let outDrag = null;
$('outTrack').addEventListener('pointerdown', (event) => {
const band = cfg.bands[sel];
const rect = $('outTrack').getBoundingClientRect();
const v = clamp01((event.clientX - rect.left - 5) / (rect.width - 10));
outDrag = { lo: Math.abs(v - band.outMin) < Math.abs(v - band.outMax), was: [band.outMin, band.outMax] };
$('outTrack').setPointerCapture(event.pointerId);
event.preventDefault();
});
$('outTrack').addEventListener('pointermove', (event) => {
if (!outDrag) return;
const band = cfg.bands[sel];
const rect = $('outTrack').getBoundingClientRect();
const v = clamp01((event.clientX - rect.left - 5) / (rect.width - 10));
if (outDrag.lo) band.outMin = Math.min(v, band.outMax - PFMap.MIN_OUT);
else band.outMax = Math.max(v, band.outMin + PFMap.MIN_OUT);
renderSettings(); drawCurve();
});
$('outTrack').addEventListener('pointerup', () => {
if (outDrag) { outDrag = null; persist(); }
});
$('outTrack').addEventListener('pointercancel', () => {
if (!outDrag) return;
[cfg.bands[sel].outMin, cfg.bands[sel].outMax] = outDrag.was;
outDrag = null;
renderSettings(); drawCurve();
});
$('muteToggle').addEventListener('click', () => {
const band = cfg.bands[sel];
band.muted = !band.muted;
renderSettings(); renderChips(); drawPlot(); persist();
});
$('resetBand').addEventListener('click', async () => {
await flush();
const next = await A.resetBand(sel, cfg);
if (next) applyConfig(next);
});
if (A.resetAll) {
$('resetMap').hidden = false;
$('resetMap').addEventListener('click', function () { A.resetAll(this); });
}
function renderChips() {
cfg.bands.forEach((band, i) => {
const chip = $('chip' + i);
chip.classList.toggle('sel', i === sel);
chip.setAttribute('aria-pressed', i === sel);
chip.classList.toggle('mutedChip', band.muted);
chip.querySelector('.chipHz').textContent = formatHz(band.hzMin) + '–' + formatHz(band.hzMax);
drawGlyph(chip.querySelector('canvas'), band, 18, 12, theme().muted);
});
}
for (let i = 0; i < 4; i++) {
$('chip' + i).addEventListener('click', () => selectBand(i));
}
function selectBand(index) {
sel = Math.max(0, Math.min(3, index));
drawPlot();
drawCurve();
renderPresetChips();
renderSettings();
renderChips();
}
const pv = $('pv');
const pvScope = $('pvScope');
const pvCtx = pvScope.getContext('2d');
let pvW = 0, pvH = 0;
let pvSig = 'pulse';
let pvRaf = 0;
let pvTimer = 0;
let pvT = 0;
let pvLast = 0;
let pvLevel = 0;
const PV_SECONDS = 4;
const PV_STEP = 1 / 30;
let pvIn = [];
let pvOut = [];
function pvSignal(t) {
if (pvSig === 'pulse') {
const phase = t % 0.8;
const spike = phase < 0.06 ? 0.85 : 0;
return clamp01(spike + 0.07 + (Math.random() - 0.5) * 0.03);
}
if (pvSig === 'noisy') {
const spike = (t % 1.7) < 0.06 ? 0.5 : 0;
return clamp01(0.30 + 0.10 * Math.sin(t * 1.3) + (Math.random() - 0.5) * 0.22 + spike);
}
return clamp01(0.45 + 0.35 * Math.sin(t * Math.PI * 2 * 0.35) + (Math.random() - 0.5) * 0.04);
}
function pvChain(sig) {
const a = pvLevel < sig ? cfg.attack : cfg.smoothing;
pvLevel += (sig - pvLevel) * a;
const band = cfg.bands[sel];
return PFMap.output(band, PFMap.position(pvLevel, band, cfg.autoRange ? { lo: 0, hi: 1 } : null));
}
function pvDraw() {
const T = theme();
const w = pvW, h = pvH;
pvCtx.clearRect(0, 0, w, h);
pvCtx.strokeStyle = T.ruleA(0.5);
pvCtx.lineWidth = 1;
for (const v of [0.25, 0.5, 0.75]) {
const y = Math.round(h - v * h) + 0.5;
pvCtx.beginPath(); pvCtx.moveTo(0, y); pvCtx.lineTo(w, y); pvCtx.stroke();
}
const trace = (arr, color, width) => {
pvCtx.strokeStyle = color;
pvCtx.lineWidth = width;
pvCtx.beginPath();
for (let i = 0; i < arr.length; i++) {
const x = (i / (PV_SECONDS / PV_STEP)) * w;
const y = h - clamp01(arr[i]) * h;
if (i === 0) pvCtx.moveTo(x, y); else pvCtx.lineTo(x, y);
}
pvCtx.stroke();
};
trace(pvIn, T.faint, 1.2);
trace(pvOut, T.led, 2);
}
function pvTick(now) {
if (pv.hidden) return;
if (!pvLast) pvLast = now;
const target = pvT + (now - pvLast) / 1000;
pvLast = now;
let budget = 60;
while (pvT < target && budget-- > 0) {
pvT += PV_STEP;
const sig = pvSignal(pvT);
pvIn.push(sig);
pvOut.push(pvChain(sig));
const cap = PV_SECONDS / PV_STEP;
if (pvIn.length > cap) { pvIn.shift(); pvOut.shift(); }
}
if (budget < 0) pvT = target;
pvDraw();
pvSchedule();
}
function pvSchedule() {
pvRaf = requestAnimationFrame(pvTick);
clearTimeout(pvTimer);
pvTimer = setTimeout(() => {
cancelAnimationFrame(pvRaf);
pvTick(performance.now());
}, 300);
}
function pvSize() {
const dpr = window.devicePixelRatio || 1;
pvW = pvScope.clientWidth; pvH = pvScope.clientHeight;
pvScope.width = pvW * dpr; pvScope.height = pvH * dpr;
pvCtx.setTransform(dpr, 0, 0, dpr, 0, 0);
}
function pvSet(on) {
pv.hidden = !on;
$('openPreview').setAttribute('aria-pressed', on);
cancelAnimationFrame(pvRaf);
clearTimeout(pvTimer);
if (!on) return;
pvSize();
pvIn = []; pvOut = []; pvT = 0; pvLast = 0; pvLevel = 0;
pvSchedule();
}
$('openPreview').addEventListener('click', () => pvSet(pv.hidden));
document.addEventListener('keydown', (event) => {
if (event.key === 'Escape' && !pv.hidden) pvSet(false);
});
document.querySelectorAll('.pvSig').forEach((el) => {
el.addEventListener('click', () => {
pvSig = el.dataset.s;
document.querySelectorAll('.pvSig').forEach((x) => x.classList.toggle('on', x === el));
});
});
function syncAutoToggle() {
$('autoToggle').classList.toggle('on', cfg.autoRange);
$('autoToggle').setAttribute('aria-pressed', cfg.autoRange);
$('autoHint').textContent = cfg.autoRange ? HINT_AUTO : HINT_HAND;
}
$('autoToggle').addEventListener('click', () => {
cfg.autoRange = !cfg.autoRange;
syncAutoToggle();
drawPlot(); drawCurve(); renderSettings();
persist();
});
const DAMP_WORDS = [[0.25, 'tight'], [0.5, 'balanced'], [0.75, 'smooth'], [1.01, 'glassy']];
const ATK_WORDS = [[0.25, 'snap'], [0.5, 'quick'], [0.75, 'soft'], [1.01, 'lazy']];
const dampWord = (v) => DAMP_WORDS.find(([top]) => v < top)[1];
function syncDamping() {
const v = clamp01((0.9 - cfg.smoothing) / 0.85);
$('damping').value = v;
$('dampingWord').textContent = dampWord(v);
const k = clamp01((0.9 - cfg.attack) / 0.85);
$('attack').value = k;
$('attackWord').textContent = ATK_WORDS.find(([top]) => k < top)[1];
}
$('attack').addEventListener('input', () => {
const v = clamp01($('attack').value);
cfg.attack = 0.9 - v * 0.85;
$('attackWord').textContent = ATK_WORDS.find(([top]) => v < top)[1];
persist();
});
$('damping').addEventListener('input', () => {
const v = clamp01($('damping').value);
cfg.smoothing = 0.9 - v * 0.85;
$('dampingWord').textContent = dampWord(v);
persist();
});
window.addEventListener('resize', () => {
if (!cfg) return;
sizePlot();
sizeCurve();
if (!pv.hidden) pvSize();
drawPlot();
drawCurve();
renderSettings();
});
window.PFConfirm = function (button, ask) {
if (button._armed) {
if (Date.now() - button._at < 500) return false;
clearTimeout(button._armed);
button._armed = 0;
button.textContent = button._label;
return true;
}
button._label = button.textContent;
button.textContent = ask;
button._at = Date.now();
button._armed = setTimeout(() => {
button._armed = 0;
button.textContent = button._label;
}, 4000);
return false;
};
(async function init() {
const stored = await A.loadConfig();
readCaps();
cfg = PFMap.normalizeConfig(stored, CAPS);
sizePlot();
sizeCurve();
syncAutoToggle();
syncDamping();
selectBand(0);
$('ed').removeAttribute('inert');
if (A.onConfig) A.onConfig(applyConfig);
A.onFrame((state) => {
const was = String(axisDb());
frame = state || {};
if (String(axisDb()) !== was) renderSettings();
drawPlot();
drawCurve();
});
})();
</script>
</body>
</html>
)HTML";
// <gz:AUDIO_IN_INDEX_HTML> GENERATED by firmware/toolchain/console_pages.py build — do not edit.
// gzip -9 of AUDIO_IN_INDEX_HTML (57490 bytes → 17217 bytes), served with Content-Encoding: gzip.
static const uint8_t AUDIO_IN_INDEX_HTML_GZ[] PROGMEM = {
  0x1f,0x8b,0x08,0x00,0x00,0x00,0x00,0x00,0x02,0xff,0xcd,0x7d,0xdb,0x72,0xdb,0x48,
  0x96,0xe0,0xbb,0xbe,0x02,0x96,0x7b,0x4d,0xa0,0x0c,0x52,0x24,0x25,0xca,0x32,0x69,
  0xca,0x2b,0x4b,0x76,0xd9,0x51,0xbe,0x28,0x2c,0x55,0xbb,0xbb,0xb5,0xea,0x1a,0x90,
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  0x00,
};
constexpr size_t AUDIO_IN_INDEX_HTML_GZ_LEN = sizeof(AUDIO_IN_INDEX_HTML_GZ);
// </gz:AUDIO_IN_INDEX_HTML>
