// ═══════════════════════════════════════════════════════════
// PatternFlow - Device web console home (PROGMEM HTML bundle)
//
// Served at http://patternflow.local/ by core_audio_ws.h. A live status line
// (pattern, fps, heap, signal — one small JSON poll) above the feature rows,
// grouped by what they are for:
//
//   PATTERNS      01  the library            → /patterns
//   SETUP         02  Wi-Fi, 03 MQTT         → /wifi, /mqtt
//   DEVICE        04  update, 05 status      → /update, /status
//   EXPERIMENTAL  06  audio sync             → /audio
//
// The look is the device's own, not the marketing site's: near-black,
// cream type, the LED orange doing the accent work — the console is opened
// next to a glowing panel in a dark room, and a live LED frame reads right
// on black in a way it never did on paper cream. patternflow.work stays
// paper; the instrument is dark.
//
// The update banner is the browser's doing: it fetches the public flasher
// manifest over HTTPS and compares against this device's version. The
// device never talks to the internet — same ferrying trick as the community
// installer — so the check costs the firmware nothing. Silently absent when
// the site is unreachable (offline LAN) or CORS says no.
//
// License: MIT
// ═══════════════════════════════════════════════════════════
// The page body below is generated from console/home.html — edit that,
// then run: python firmware/toolchain/console_pages.py build
#pragma once
#include <pgmspace.h>

const char HOME_INDEX_HTML[] PROGMEM = R"HTML(<!doctype html>
<html lang="en">
<head>
<meta charset="utf-8">
<script src="/pf-console.js?h=efffd505"></script><script>if(!window.PF)(function(){var W=window,U='/api/status',L=[],M=2e9,S,Z,P=W.PF={state:'live',dirty:!1,v:null,get:G,inflight:Number,hold:Object,say:function(t,k,e){e&&(e.textContent=t)},busy:function(b,p){function f(){b.disabled=!1}b.disabled=!0;p.then(f,f);return p},poll:function(s,m,c,o){var t,f,g=1;function R(){g&&!f&&(f=1,clearTimeout(t),(s.call?s():G(s)).then(function(d){c(d,null)},function(e){c(null,e)}).then(K,K))}function K(){f=0;clearTimeout(t);g&&(t=setTimeout(R,m))}o&&o.first===!1?K():R();return{stop:function(){g=0;clearTimeout(t)},set:function(n){m=n;f||K()},now:R}},status:function(c){c&&L.push(c);S?c&&c(S):Z?Z.now():Z=P.poll(U,M,D)},watchStatus:function(m){P.status();Z.set(M=Math.min(m,M))},waitForDevice:function(o){o=o||{};return new Promise(function(y,n){var h=P.poll(U,2e3,function(s){s&&!(o.build&&s.build==o.build)&&(h.stop(),y(s))});setTimeout(function(){h.stop();n(Error('timeout'))},o.timeout||9e4)})}};function G(u,o){return fetch(u,o).then(function(r){if(!r.ok)throw Error(r.status);return o&&o.text?r.text():r.json()})}function D(s){if(s){S=W.pfStatus=s;L.forEach(function(f){f(s)})}}})()</script>
<meta name="viewport" content="width=device-width,initial-scale=1">
<title>Patternflow</title>
<link rel="icon" href="data:image/svg+xml,%3Csvg xmlns='http://www.w3.org/2000/svg' viewBox='0 0 16 16'%3E%3Crect width='16' height='16' rx='3' fill='%23161512'/%3E%3Crect x='5' y='5' width='6' height='6' fill='%23FF5C2E'/%3E%3C/svg%3E">
<style>
/* Console base: the same block opens every core page. Light in :root (the chrome's
   injected light palette holds these same values: keep the two in step),
   dark under html[data-theme=dark]. No web fonts: the hotspot has no internet. */
:root{color-scheme:light;--cream:#F4EFE6;--panel:#FFFCFA;--ink:#1A1814;--muted:#625C51;--faint:#7D7668;--rule:#DDD5C6;--rule-soft:#E8E1D4;--ghost:#E3DCCE;--led:#FF5C2E;--bad:#B83C1C;--ok:#2B7A4B;--warn:#85600E;
--sans:system-ui,-apple-system,'Segoe UI',Roboto,sans-serif;--mono:ui-monospace,'Cascadia Mono','SF Mono',Menlo,Consolas,'Roboto Mono',monospace}
html[data-theme=dark]{color-scheme:dark;--cream:#0C0B09;--panel:#131110;--ink:#EDE7DB;--muted:#A39B8A;--faint:#7A7364;--rule:#2B2721;--rule-soft:#1F1C18;--ghost:#2A2620;--bad:#FF7A55;--ok:#57B87F;--warn:#D9A03F}
*{box-sizing:border-box}[hidden]{display:none!important}
body{margin:0;background:var(--cream);color:var(--ink);font:15px/1.5 var(--sans);-webkit-font-smoothing:antialiased}
a{color:inherit}:focus-visible{outline:2px solid var(--led);outline-offset:2px}
.wrap{max-width:720px;margin:0 auto;padding:20px 16px 48px}
h2{margin:0 0 6px;font-size:13px;font-weight:600;color:var(--muted)}
.card{background:var(--panel);border:1px solid var(--rule);border-radius:10px;padding:16px}
.btn{display:inline-flex;align-items:center;justify-content:center;gap:6px;min-height:40px;padding:0 16px;border:1px solid var(--rule);border-radius:8px;background:var(--panel);color:var(--ink);font:500 14px var(--sans);text-decoration:none;cursor:pointer;transition:border-color .15s,background .15s,color .15s}
@media(hover:hover){.btn:hover{border-color:var(--ink)}.btn.pri:hover{background:var(--led);border-color:var(--led);color:#fff}footer a:hover,.kt :hover{color:var(--ink)}}
.btn:disabled{opacity:.45;cursor:default;border-color:var(--rule)}
.btn.pri{background:var(--ink);border-color:var(--ink);color:var(--cream)}
.btn.ic{width:40px;padding:0}
.msg{font:12px var(--mono);color:var(--faint)}.pf-ok{color:var(--ok)}.pf-err{color:var(--bad)}
.chip{display:inline-block;padding:0 8px;border:1px solid var(--rule);border-radius:99px;font:11px/20px var(--mono);color:var(--muted);white-space:nowrap}
.notice{display:block;padding:12px 14px;border:1px solid var(--rule);border-left:3px solid var(--led);border-radius:8px;background:var(--panel);font-size:14px;text-decoration:none}.notice b{font-weight:500;white-space:nowrap}
footer{display:flex;align-items:center;justify-content:space-between;gap:16px;margin-top:40px;border-top:1px solid var(--rule);font:12px var(--mono);color:var(--faint)}
footer a{display:inline-flex;align-items:center;min-height:40px;color:var(--muted);text-decoration:none}
/* Range: --p is the filled part, set by fill() in the script. */
input[type=range]{-webkit-appearance:none;appearance:none;display:block;width:100%;height:28px;margin:0;background:linear-gradient(90deg,var(--ink) var(--p,50%),var(--ghost) 0) center/100% 4px no-repeat;cursor:pointer;touch-action:pan-y}
input[type=range]::-webkit-slider-thumb{-webkit-appearance:none;width:20px;height:20px;border-radius:50%;background:var(--panel);border:2px solid var(--ink);transition:border-color .15s}
input[type=range]::-moz-range-thumb{box-sizing:border-box;width:20px;height:20px;border-radius:50%;background:var(--panel);border:2px solid var(--ink)}
input[type=range]:active::-webkit-slider-thumb{border-color:var(--led)}input[type=range]:active::-moz-range-thumb{border-color:var(--led)}
@media(pointer:coarse){input[type=range]{height:40px}input[type=range]::-webkit-slider-thumb{width:26px;height:26px}input[type=range]::-moz-range-thumb{width:26px;height:26px}}
/* ── Home ── */
.lbl{font-size:13px;font-weight:500;color:var(--muted);margin:0}
.hd{display:flex;align-items:center;gap:8px}.hd .lbl{flex:1}
.hd .msg{min-width:0;overflow:hidden;text-overflow:ellipsis;white-space:nowrap}
.now{font-size:28px;font-weight:600;letter-spacing:-.02em;line-height:1.15;margin:2px 0 4px;min-height:32px;overflow-wrap:anywhere}
.nsub{display:flex;flex-wrap:wrap;align-items:center;gap:6px 10px;min-height:20px;font:12px var(--mono);color:var(--muted)}
.blk{margin-top:16px;padding-top:16px;border-top:1px solid var(--rule-soft)}
.row{display:flex;align-items:center;gap:12px}.row .lbl{flex:1}
.seg{display:inline-flex;gap:2px;padding:2px;border:1px solid var(--rule);border-radius:9px;background:var(--cream)}
.seg button{min-height:40px;min-width:76px;padding:0 16px;border:0;border-radius:7px;background:none;color:var(--muted);font:500 14px var(--sans);cursor:pointer;transition:background .15s,color .15s}
.seg button:hover{color:var(--ink)}
.seg button.on{background:var(--panel);color:var(--ink);box-shadow:0 0 0 1px var(--rule),inset 0 -2px var(--led)}
#pwrnote{min-height:18px;margin:6px 0 4px}
.val{font:12px var(--mono);color:var(--muted)}
.kn{display:grid;grid-template-columns:28px 1fr 28px;align-items:center;column-gap:10px;margin-top:4px}
.kn label{font:600 12px var(--mono);color:var(--muted)}.kn .val{text-align:right}
/* Several knobs at once: quiet, under the four. */
.kt{display:flex;gap:20px;padding-left:38px;font-size:13px;color:var(--muted)}
.kt>*{display:inline-flex;align-items:center;gap:8px;min-height:40px;padding:0;border:0;background:none;color:inherit;font:inherit;cursor:pointer}
.kt input{width:16px;height:16px;margin:0;accent-color:var(--ink)}
.kt button{text-decoration:underline var(--faint);text-underline-offset:4px}
#upd{margin-top:16px;display:flex;flex-wrap:wrap;gap:4px 12px;align-items:baseline}#upd span{flex:1}
#upd:hover b{text-decoration:underline}
.pf-offline .now,.pf-offline .f .v{opacity:.5}
.side,.side h2{margin-top:28px}.side h2+*{border-top:1px solid var(--rule)}
/* Edition */
.edn{font-size:22px;font-weight:600;line-height:1.3;overflow-wrap:anywhere}
.note{margin:8px 0 0;font-size:13px;color:var(--muted)}
#s-feat{display:flex;flex-wrap:wrap;gap:8px;margin-top:12px}
#s-feat .btn{position:relative;min-height:32px;padding:0 12px;border-radius:99px;font-size:13px}
@media(pointer:coarse){#s-feat .btn::after{content:"";position:absolute;inset:-4px 0}}
#s-ed-block{width:100%;margin-top:16px}
.f{display:flex;align-items:baseline;gap:12px;padding:8px 0;border-bottom:1px solid var(--rule-soft);font-size:13px;text-decoration:none}
.f .k{flex:none;width:84px;color:var(--muted)}
.f .v{flex:1;min-width:0;font:12.5px var(--mono);text-align:right;overflow-wrap:anywhere}
.bar{display:block;height:3px;margin:5px 0 2px auto;max-width:160px;background:var(--ghost)}
.bar i{display:block;height:100%;width:0;background:var(--led);transition:width .3s}
/* A description that does not fit beside its title wraps under it, whole. */
.links a{position:relative;display:flex;align-items:baseline;column-gap:10px;min-height:44px;padding:10px 24px 10px 0;border-bottom:1px solid var(--rule-soft);text-decoration:none}
.links b{font-weight:500;white-space:nowrap}.links a:hover b{text-decoration:underline}
.links small{flex:1;min-width:0;overflow:hidden;text-overflow:ellipsis;white-space:nowrap;font-size:13px;color:var(--muted)}
.links a::after{content:"\2192";position:absolute;right:0;top:10px;color:var(--faint)}
.pf-info{color:var(--muted)}
#featRows{display:contents}
@media(min-width:960px){.wrap{max-width:1080px;padding-top:32px}
 .grid{display:grid;grid-template-columns:minmax(0,1fr) 380px;gap:48px;align-items:start}
 .ctl{position:sticky;top:20px}.side{margin-top:0}.card{padding:24px}.now{font-size:34px}}
</style></head><body>

<main class="wrap">
  <a class="notice" id="hsCall" href="/wifi" hidden style="margin-bottom:16px">You&rsquo;re on the panel&rsquo;s own network. <b>Add your Wi-Fi &rarr;</b></a>

  <div class="grid">
  <div class="ctl">
  <div class="card">
    <div class="hd">
      <h1 class="lbl">Now playing</h1>
      <span class="msg" id="stepmsg"></span>
      <button class="btn ic" id="pat-prev" title="Previous pattern (&larr;)" aria-label="Previous pattern" type="button">&larr;</button>
      <button class="btn ic" id="pat-next" title="Next pattern (&rarr;)" aria-label="Next pattern" type="button">&rarr;</button>
    </div>
    <div class="now" id="now">&mdash;</div>
    <div class="nsub"><span id="nowsub"></span><span class="chip" id="nowperf" hidden></span></div>

    <div class="blk">
      <div class="row">
        <span class="lbl">Panel</span>
        <div class="seg" role="group" aria-label="Panel">
          <button id="p-on" type="button">On</button>
          <button id="p-sleep" type="button">Sleep</button>
        </div>
      </div>
      <div class="msg" id="pwrnote"></div>
      <div class="row"><label class="lbl" for="bri">Brightness</label><span class="val" id="bri-v">&mdash;</span></div>
      <input type="range" id="bri" min="2" max="100" step="1" value="80">
    </div>

    <div class="blk" id="ctrls">
      <div class="hd"><span class="lbl">Knobs</span><span class="msg" id="ctrlmsg"></span></div>
      <div class="kn"><label for="sl-0">K1</label><input type="range" id="sl-0" min="0" max="100" step="1" value="50"><span class="val" id="kv-0">&mdash;</span></div>
      <div class="kn"><label for="sl-1">K2</label><input type="range" id="sl-1" min="0" max="100" step="1" value="50"><span class="val" id="kv-1">&mdash;</span></div>
      <div class="kn"><label for="sl-2">K3</label><input type="range" id="sl-2" min="0" max="100" step="1" value="50"><span class="val" id="kv-2">&mdash;</span></div>
      <div class="kn"><label for="sl-3">K4</label><input type="range" id="sl-3" min="0" max="100" step="1" value="50"><span class="val" id="kv-3">&mdash;</span></div>
      <div class="kt">
        <label><input type="checkbox" id="ktog">Together</label>
        <button type="button" id="kshuf">Shuffle</button>
        <button type="button" id="kundo" hidden>Undo</button>
      </div>
    </div>
  </div>
  </div>

  <div class="side">
    <!-- A card with a button: nobody clicks a fact row. -->
    <div class="card">
      <p class="lbl">Edition</p>
      <div class="edn" id="s-ed">&mdash;</div>
      <div class="val" id="s-fw"></div>
      <p class="note" id="s-ed-sub" hidden>Standard firmware, no extra features.</p>
      <div id="s-feat" hidden></div>
      <!-- Points at the SITE, not this device's own /update: that page reads the
           release manifest and hands the new image to this board over Wi-Fi. -->
      <a class="notice" id="upd" href="https://patternflow.work/update" target="_blank" rel="noopener" hidden>
        <span id="updtext"></span><b>How to update &rarr;</b></a>
      <a class="btn" id="s-ed-block" href="https://patternflow.work/editions" target="_blank" rel="noopener">Editions &rarr;</a>
      <p class="note" id="s-ed-off" hidden>Editions are listed at patternflow.work/editions; the panel&rsquo;s own network has no internet.</p>
      <p class="note">Installing another keeps your patterns and settings.</p>
    </div>

    <h2>Device</h2>
    <div>
      <div class="f"><span class="k">Patterns</span><span class="v" id="s-pat">&mdash;</span></div>
      <div class="f"><span class="k">Storage</span><span class="v"><span id="s-fs">&mdash;</span><span class="bar"><i id="s-fsbar"></i></span></span></div>
      <div class="f"><span class="k">Wi-Fi</span><span class="v" id="s-wifi">&mdash;</span></div>
      <div class="f"><span class="k">Address</span><span class="v" id="s-ip">&mdash;</span></div>
      <!-- The panel's own access point, while it is up: a separate network
           from the one above, so its own line. -->
      <div class="f" id="s-hs-b" hidden><span class="k">Hotspot</span><span class="v" id="s-hs">&mdash;</span></div>
      <div class="f"><span class="k">Memory</span><span class="v" id="s-heap">&mdash;</span></div>
      <div class="f"><span class="k">Uptime</span><span class="v" id="s-up">&mdash;</span></div>
    </div>

    <h2>Pages</h2>
    <!-- Feature rows are not written here: they arrive from /api/status
         featureNav, contributed by the loaded features (see gate()). -->
    <nav class="links">
      <a href="/patterns"><b>Patterns</b><small>Upload .pfm or .zip, play, arrange, delete</small></a>
      <div id="featRows" hidden></div>
      <a href="/wifi"><b>Wi-Fi</b><small>Saved networks (joins any in range), hotspot</small></a>
      <a href="/knobs"><b>Knobs</b><small>Direction and click size</small></a>
      <a href="/update"><b>Update</b><small>Install new firmware; patterns and Wi-Fi stay</small></a>
      <a href="/status"><b>Status</b><small>Frame rate, memory, storage, network</small></a>
    </nav>
  </div>
  </div>

  <footer><span id="host"></span>
    <a href="https://patternflow.work" target="_blank" rel="noopener">patternflow.work</a></footer>
</main>

<script>
function $(i){return document.getElementById(i)}
$('host').textContent=location.hostname;

// A range's filled part (--p) follows its value.
function fill(el){el.style.setProperty('--p',(el.value-el.min)/(el.max-el.min)*100+'%')}
document.addEventListener('input',function(e){if(e.target.type==='range')fill(e.target)});

// ── What this build actually has ───────────────────────────────
// Feature rows, and the edition card's chips, come from /api/status
// featureNav (path, label, one line): a build with none gets none, and a
// page the core never heard of still gets a row. Rebuilt only when it
// changes: a rebuild under the pointer drops hover and focus.
var navKey;
function gate(s){
  var i,nav=(s&&s.featureNav)||[],k=JSON.stringify(nav),f=$('featRows'),c=$('s-feat');
  if(k===navKey)return;
  navKey=k;
  f.innerHTML=c.innerHTML='';
  for(i=0;i<nav.length;i++){
    var e=nav[i];if(!e||e.length<2)continue;
    var a=document.createElement('a');
    a.href=e[0];a.innerHTML='<b></b><small></small>';
    a.firstChild.textContent=e[1];
    a.lastChild.textContent=e[2]||'';
    f.appendChild(a);
    a=document.createElement('a');
    a.href=e[0];a.className='btn';a.textContent=e[1];
    c.appendChild(a);
  }
  f.hidden=c.hidden=!f.firstChild;
}

// ── Device card ───────────────────────────────────────────────
// Everything here is /api/status: the chrome's copy (PF.status), fresh
// every 3 s (PF.watchStatus). The device streams no pixels (see
// core_patterns_http.h).
function dur(s){
  var d=Math.floor(s/86400),h=Math.floor(s%86400/3600),m=Math.floor(s%3600/60);
  if(d)return d+'d '+h+'h';if(h)return h+'h '+m+'m';
  if(m)return m+'m';return s+'s';
}
// Optional status chips from feature appendStatus fields. Labels stay
// feature-agnostic so this core page never names a feature.
function paintPerf(s){
  var el=$('nowperf'),t=[];
  if(s.mqttRole==='publisher')t.push('Pub');
  else if(s.mqttRole==='subscriber')t.push('Sub');
  if(typeof s.sequenceMode==='boolean')
    t.push(s.sequenceMode?'Playlist':'Browse');
  el.hidden=!t.length;el.textContent=t.join(' · ');
}
var last=null;
function paint(s){
  last=s;
  gate(s);
  // Asleep outranks paused: a sleeping device is asleep whatever else is
  // going on, and its frame rate would be from before it went dark.
  if(s.sleep){
    $('now').textContent='Asleep';
    $('nowsub').textContent=s.active?(s.active+' resumes on wake'):'panel off';
  }else if(s.consolePaused){
    // An upload batch or a format holding the pattern's memory.
    $('now').textContent='Paused';
    $('nowsub').textContent='writing patterns — resumes when done';
  }else if(s.loading&&s.active==='-'){
    // A module loads on the other core and `active` reads "-" meanwhile:
    // keep the name a step just painted.
    $('nowsub').textContent='loading…';
  }else{
    $('now').textContent=s.active||'—';
    $('nowsub').textContent=(s.frameUs?Math.round(1e6/s.frameUs)+' fps · ':'')+
      (s.activeIsModule?'module':'built in');
  }
  paintPerf(s);
  paintPower(s.sleep);
  paintBrightness(s.brightness);
  $('s-pat').textContent=s.patterns+' ('+s.presets+' built in, '+s.modules+' modules)';
  if(s.fsMounted){
    $('s-fs').textContent=Math.round((s.fsTotal-s.fsUsed)/1048576*10)/10+' MB free';
    $('s-fsbar').style.width=(s.fsTotal?s.fsUsed/s.fsTotal*100:0)+'%';
  }else{$('s-fs').textContent='not mounted'}
  // The joined network and the panel's own hotspot can be up together.
  var hs=s.hotspot||{},n=hs.clients|0;
  $('s-wifi').textContent=s.wifi?(s.ssid+' · '+s.rssi+' dBm'):hs.up?'not connected':'offline';
  $('s-ip').textContent=s.wifi?s.ip:'—';
  $('s-hs-b').hidden=!hs.up;
  if(hs.up)$('s-hs').textContent=hs.ssid+' · '+(hs.ip||'192.168.4.1')+' · '+n+(n===1?' client':' clients');
  // Reached over that hotspot with no home network joined: the one useful
  // next step is giving the panel one.
  $('hsCall').hidden=!(s.viaHotspot&&!s.wifi);
  $('s-heap').textContent=Math.round(s.heapInternal/1024)+'K + '+
    Math.round(s.heapPsram/1048576)+'M PSRAM';
  $('s-up').textContent=dur(s.uptime);

  // Edition: as its own page spells it, else a plain slug capitalised and a
  // hyphenated one as is. No link that cannot open: the panel's own network
  // has no internet (net: the site answered anyway).
  var ed=s.variant&&s.variant!=='core'?s.variant:'',b=$('s-ed-block'),nm=/-/.test(ed)?ed:ed.charAt(0).toUpperCase()+ed.slice(1);
  (s.featureNav||[]).forEach(function(e){if(e&&(''+e[1]).toLowerCase()==ed)nm=e[1]});
  $('s-ed').textContent=nm||'Patternflow';
  $('s-fw').textContent=(ed?(s.variantVersion?s.variantVersion+' · ':'')+'core ':'')+'v'+s.version;
  $('s-ed-sub').hidden=ed||!$('s-feat').hidden;
  b.textContent=(ed?'Other editions':'Editions')+' →';
  b.href='https://patternflow.work/editions'+(ed?'#'+encodeURIComponent(ed):'');
  b.hidden=s.viaHotspot&&!net;$('s-ed-off').hidden=!b.hidden;
  updateSliders(s);
  checkUpdate(s.version,s.variant);
}

// ── Panel switch ──────────────────────────────────────────────
// A VIEW of the device's state: K1 and other inputs change the same thing,
// and the 3 s status keeps it honest. POST /api/sleep only queues the
// change (loop() performs it next pass), so a status landing in between
// still says the old value: settleUntil holds the click's state a beat past
// the reply, and the next status after it confirms.
var settleUntil=0;
function paintPower(asleep,force){
  if(!force&&Date.now()<settleUntil)return;
  $('p-on').className=asleep?'':'on';
  $('p-sleep').className=asleep?'on':'';
  $('p-on').setAttribute('aria-pressed',!asleep);
  $('p-sleep').setAttribute('aria-pressed',!!asleep);
}
function note(t,k){PF.say(t,k||'info',$('pwrnote'))}
function setPower(asleep){
  settleUntil=Date.now()+1500;
  paintPower(asleep,true);
  note(asleep?'sleeping…':'waking…');
  fetch('/api/sleep',{method:'POST',cache:'no-store',
      headers:{'Content-Type':'application/x-www-form-urlencoded'},
      body:'on='+(asleep?'1':'0')})
    .then(function(r){if(!r.ok)throw 0;return r.json()})
    .then(function(){
      settleUntil=Math.max(settleUntil,Date.now()+800);
      note(asleep?'panel off — any knob or button wakes it':'');
    })
    .catch(function(){
      // Back to what the panel last said, not what was clicked.
      settleUntil=0;
      if(last)paintPower(last.sleep);
      note('not switched — the panel did not answer','err');
    });
}
$('p-on').addEventListener('click',function(){setPower(false)});
$('p-sleep').addEventListener('click',function(){setPower(true)});

// ── Brightness ────────────────────────────────────────────────
// A view like the switch: K1's long-press session moves the same number.
// GET /api/display?brightness= is the write - one in flight, the newest
// value waiting behind it, so a drag cannot queue up on the server.
var briActive=false,briInFlight=false,briQueued=-1,briSettleUntil=0;
function briPct(b){return Math.max(2,Math.min(100,Math.round(b*100/255)))}
function paintBrightness(b){
  if(briActive||Date.now()<briSettleUntil||typeof b!=='number')return;
  var p=briPct(b);$('bri').value=p;fill($('bri'));$('bri-v').textContent=p+'%';
}
function pumpBri(){
  if(briInFlight||briQueued<0)return;
  var p=briQueued;briQueued=-1;briInFlight=true;
  var v=Math.max(5,Math.min(255,Math.round(p*255/100)));
  function done(){briInFlight=false;if(briQueued>=0)pumpBri()}
  PF.get('/api/display?brightness='+v).then(done,function(x){
    if(!x||!x.nav)note('brightness not set — '+(x&&x.status?'refused':'the panel did not answer'),'err');
    done();
  });
}
$('bri').addEventListener('input',function(){
  var p=parseInt(this.value,10);if(isNaN(p))return;
  $('bri-v').textContent=p+'%';briQueued=p;briSettleUntil=Date.now()+1500;pumpBri();
});
// Pointer events, and pointercancel with them: with pan-y a vertical swipe
// that starts on a slider becomes a scroll, which ends in pointercancel,
// never an up, and "a hand is on it" would stick.
function held(sl,on,off){
  var down=false;
  function up(){if(down){down=false;off()}}
  sl.addEventListener('pointerdown',function(){down=true;on()});
  window.addEventListener('pointerup',up);
  window.addEventListener('pointercancel',up);
}
held($('bri'),function(){briActive=true},function(){briActive=false;briSettleUntil=Date.now()+1500});

// ── Update check (runs in the browser, never on the device) ───
// The manifest describes CORE releases: on a variant this stays quiet,
// since offering one would talk someone into flashing away the edition
// they chose, by a version comparison across two release lines.
var updChecked=false,net=0;
function checkUpdate(deviceVersion,variant){
  if(updChecked||!deviceVersion)return;
  if(variant&&variant!=='core')return;
  updChecked=true;
  fetch('https://patternflow.work/flash/manifest.json',{cache:'no-store'})
    .then(function(r){if(!r.ok)throw 0;return r.json()})
    .then(function(m){
      net=1;$('s-ed-block').hidden=0;$('s-ed-off').hidden=1;
      var latest=String(m.version||'').replace(/^v/,'');
      if(latest&&latest!==deviceVersion){
        $('updtext').textContent='v'+latest+' is out — this panel runs v'+deviceVersion+'.';
        $('upd').hidden=false;
      }
    }).catch(function(){/* offline LAN or no CORS — say nothing */});
}

// ── Knob sliders (K1..K4 · 0..100) ────────────────────────────
// kv: what the four show. A status moves none while a hand is on one, or
// for a beat after a write it may predate.
var activeSlider=-1,inFlight=false,queuedParams={},kv=[],kBase=null,kSettle=0,kShown,undo,undoT,tog=$('ktog');
function setK(i,v){
  v=v<0?0:v>100?100:v;kv[i]=v;
  var sl=$('sl-'+i);sl.value=v;fill(sl);$('kv-'+i).textContent=v;
}
// A free lane reports its last held value: painted once, then left alone
// (Undo may just have freed it).
function updateSliders(s){
  var p=s.params,a=s.paramActive;
  if(!p||p.length<4||activeSlider>=0||Date.now()<kSettle)return;
  for(var i=0;i<4;i++)if(!kShown||!a||a[i])setK(i,Math.round(p[i]/10));
  kShown=1;
}
// The four in one request: the server takes one connection at a time.
// f[j]: free lane j (rN) instead.
function sendAll(v,f){
  for(var j=0;j<4;j++){
    setK(j,v[j]);
    if(f&&f[j]){delete queuedParams['p'+(j+1)];queuedParams['r'+(j+1)]=1}
    else queuedParams['p'+(j+1)]=kv[j]*10;
  }
  kSettle=Date.now()+1500;pumpParams();
}
function pumpParams(){
  if(inFlight)return; // one in flight; the newest values wait in the queue
  var keys=Object.keys(queuedParams),body=[],i;
  if(!keys.length)return;
  for(i=0;i<keys.length;i++)body.push(keys[i]+'='+encodeURIComponent(queuedParams[keys[i]]));
  queuedParams={};
  inFlight=true;
  fetch('/api/params',{method:'POST',cache:'no-store',
      headers:{'Content-Type':'application/x-www-form-urlencoded'},body:body.join('&')})
    .then(function(r){
      if(!r.ok)throw Error('refused');
      $('ctrlmsg').textContent='';
    }).catch(function(x){
      // Said next to the sliders: a drag that never arrived looks exactly
      // like a pattern ignoring its knobs.
      PF.say('not sent — '+(x&&x.message==='refused'?'refused':'no answer'),'err',$('ctrlmsg'));
    }).then(function(){
      inFlight=false;kSettle=Date.now()+1500;
      if(Object.keys(queuedParams).length)pumpParams();
    });
}
// pX on the 0..1000 bus. The device derives the clicks a legacy pattern
// reads from the change in the held value, so no dX alongside - sending
// both counted every move twice.
// Together: each knob moves by what the held one moved since the gesture
// began (kBase), clamped, so dragging back undoes a clamp.
[0,1,2,3].forEach(function(idx){
  var sl=$('sl-'+idx);
  kv[idx]=+sl.value;
  held(sl,function(){activeSlider=idx},function(){
    if(activeSlider===idx)activeSlider=-1;
    kBase=null;
    pumpParams();
  });
  sl.addEventListener('input',function(){
    var v=+sl.value,j;
    if(!kBase)kBase=kv.slice();
    for(j=0;j<4;j++)if(j===idx||tog.checked){
      setK(j,kBase[j]+v-kBase[idx]);
      queuedParams['p'+(j+1)]=kv[j]*10;
    }
    kSettle=Date.now()+1500;dropUndo();
    pumpParams();
  });
  // A key press is a whole gesture.
  sl.addEventListener('change',function(){kBase=null});
});
try{tog.checked=localStorage.getItem('pf-together')==1}catch(e){}
tog.onchange=function(){try{localStorage.setItem('pf-together',tog.checked?1:0)}catch(e){}};
// Undo: one level, until the next knob change or 12 s. Shuffle held all
// four; a lane something else drove before is freed back to it.
function dropUndo(){undo=0;$('kundo').hidden=true;clearTimeout(undoT)}
$('kshuf').onclick=function(){
  var s=last||{},a=s.paramActive||[],l=s.laneActive||[],r=[],f=[],j;
  for(j=0;j<4;j++){r[j]=Math.floor(Math.random()*101);f[j]=!a[j]&&l[j]}
  f=[kv.slice(),f];
  sendAll(r);dropUndo();
  if(last){undo=f;$('kundo').hidden=false;undoT=setTimeout(dropUndo,12000)}
};
$('kundo').onclick=function(){
  if(undo){sendAll(undo[0],undo[1]);dropUndo();$('kshuf').focus()}
};

// ── Pattern stepping (← / →) ─────────────────────────────────
// The reply names the new pattern; the next status confirms it. One step
// in flight (?step is ±1); presses meanwhile add up in pend.
var stepping=0,pend=0;
function stepPattern(dir){
  if(stepping){pend+=dir;return}
  var prev=$('now').textContent;
  $('now').textContent=dir>0?'Next…':'Prev…';
  stepping=1;
  PF.get('/api/patterns/select?step='+dir).then(function(d){
    stepping=0;
    $('now').textContent=d.name||prev;
    $('nowsub').textContent='switched';
    $('stepmsg').textContent='';
    if(pend){dir=pend>0?1:-1;pend-=dir;stepPattern(dir)}
  },function(x){
    stepping=pend=0;
    $('now').textContent=prev;
    if(!x||!x.nav)
      PF.say(x&&x.status===404?'nothing to switch to':'not switched','err',$('stepmsg'));
  });
}
$('pat-prev').addEventListener('click',function(){stepPattern(-1)});
$('pat-next').addEventListener('click',function(){stepPattern(1)});
// The arrow keys too, unless a field or slider has them or a modifier is
// held (Alt+Left is Back).
document.addEventListener('keydown',function(e){
  var d=e.key=='ArrowLeft'?-1:e.key=='ArrowRight'?1:0;
  if(!d||e.repeat||e.altKey||e.ctrlKey||e.metaKey||e.shiftKey||/^(INPUT|SELECT|TEXTAREA)$/.test(e.target.tagName))return;
  e.preventDefault();stepPattern(d);
});

[].forEach.call(document.querySelectorAll('input[type=range]'),fill);
PF.watchStatus(3000);
PF.status(paint);
</script>
</body></html>
)HTML";
// <gz:HOME_INDEX_HTML> GENERATED by firmware/toolchain/console_pages.py build — do not edit.
// gzip -9 of HOME_INDEX_HTML (29218 bytes → 10498 bytes), served with Content-Encoding: gzip.
const uint8_t HOME_INDEX_HTML_GZ[] PROGMEM = {
  0x1f,0x8b,0x08,0x00,0x00,0x00,0x00,0x00,0x02,0xff,0xcd,0x7d,0xdb,0x76,0xdb,0x48,
  0x92,0xe0,0xbb,0xbe,0x22,0x4d,0x77,0x09,0x40,0x09,0xbc,0xea,0x62,0x99,0x14,0xac,
  0x95,0x65,0xb9,0xdb,0xeb,0x4b,0x69,0x2d,0x7b,0xaa,0xb7,0xbd,0x9e,0x1e,0x90,0x48,
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  0x00,0x00,
};
constexpr size_t HOME_INDEX_HTML_GZ_LEN = sizeof(HOME_INDEX_HTML_GZ);
// </gz:HOME_INDEX_HTML>
