// ═══════════════════════════════════════════════════════════
// PatternFlow - Browser self-update page (PROGMEM HTML bundle)
//
// Served at http://patternflow.local/update by core_web_update.h.
// Drop a firmware .bin (the app image the web build service emits, or an
// arduino-cli export) and the device flashes itself via Update.h.
//
// The page polls /update/status: stock builds are always ready
// (PF_WEBUPDATE_ALWAYS_ARMED 1); builds that opted into physical arming
// show a LOCKED tag plus the how-to-arm note until the UPDATE screen is
// opened on the device. Upload progress is the XHR's own send progress —
// the device flashes as it receives, so the bar tracks the actual write
// within a buffer's worth.
//
// Styled to the patternflow.work design system (web/docs/
// patternflow-styleguide.html): cream + ink + LED accent, thin rules,
// mono kickers/tags, dashed placeholder-style drop zone.
//
// License: MIT
// ═══════════════════════════════════════════════════════════
// The page body below is generated from console/update.html — edit that,
// then run: python firmware/toolchain/console_pages.py build
#pragma once
#include <pgmspace.h>

const char WEB_UPDATE_HTML[] PROGMEM = R"HTML(<!doctype html>
<html lang="en">
<head>
<meta charset="utf-8">
<script src="/pf-console.js?h=efffd505"></script><script>if(!window.PF)(function(){var W=window,U='/api/status',L=[],M=2e9,S,Z,P=W.PF={state:'live',dirty:!1,v:null,get:G,inflight:Number,hold:Object,say:function(t,k,e){e&&(e.textContent=t)},busy:function(b,p){function f(){b.disabled=!1}b.disabled=!0;p.then(f,f);return p},poll:function(s,m,c,o){var t,f,g=1;function R(){g&&!f&&(f=1,clearTimeout(t),(s.call?s():G(s)).then(function(d){c(d,null)},function(e){c(null,e)}).then(K,K))}function K(){f=0;clearTimeout(t);g&&(t=setTimeout(R,m))}o&&o.first===!1?K():R();return{stop:function(){g=0;clearTimeout(t)},set:function(n){m=n;f||K()},now:R}},status:function(c){c&&L.push(c);S?c&&c(S):Z?Z.now():Z=P.poll(U,M,D)},watchStatus:function(m){P.status();Z.set(M=Math.min(m,M))},waitForDevice:function(o){o=o||{};return new Promise(function(y,n){var h=P.poll(U,2e3,function(s){s&&!(o.build&&s.build==o.build)&&(h.stop(),y(s))});setTimeout(function(){h.stop();n(Error('timeout'))},o.timeout||9e4)})}};function G(u,o){return fetch(u,o).then(function(r){if(!r.ok)throw Error(r.status);return o&&o.text?r.text():r.json()})}function D(s){if(s){S=W.pfStatus=s;L.forEach(function(f){f(s)})}}})()</script>
<meta name="viewport" content="width=device-width,initial-scale=1">
<title>Patternflow — Firmware update</title>
<style>
/* Console base: the same block opens every core page. Light in :root (the chrome's
   injected light palette holds these same values: keep the two in step),
   dark under html[data-theme=dark]. No web fonts: the hotspot has no internet. */
:root{color-scheme:light;--cream:#F4EFE6;--panel:#FFFCFA;--ink:#1A1814;--muted:#625C51;--faint:#7D7668;--rule:#DDD5C6;--rule-soft:#E8E1D4;--ghost:#E3DCCE;--led:#FF5C2E;--bad:#B83C1C;--ok:#2B7A4B;--warn:#85600E;
--sans:system-ui,-apple-system,'Segoe UI',Roboto,sans-serif;--mono:ui-monospace,'Cascadia Mono','SF Mono',Menlo,Consolas,'Roboto Mono',monospace}
html[data-theme=dark]{color-scheme:dark;--cream:#0C0B09;--panel:#131110;--ink:#EDE7DB;--muted:#A39B8A;--faint:#7A7364;--rule:#2B2721;--rule-soft:#1F1C18;--ghost:#2A2620;--bad:#FF7A55;--ok:#57B87F;--warn:#D9A03F}
*{box-sizing:border-box}[hidden]{display:none!important}
body{margin:0;background:var(--cream);color:var(--ink);font:15px/1.5 var(--sans);-webkit-font-smoothing:antialiased}
a{color:inherit}:focus-visible{outline:2px solid var(--led);outline-offset:2px}
.wrap{max-width:720px;margin:0 auto;padding:20px 16px 48px}
h2{margin:0 0 6px;font-size:13px;font-weight:600;color:var(--muted)}
.btn{display:inline-flex;align-items:center;justify-content:center;gap:6px;min-height:40px;padding:0 16px;border:1px solid var(--rule);border-radius:8px;background:var(--panel);color:var(--ink);font:500 14px var(--sans);text-decoration:none;cursor:pointer;transition:border-color .15s,background .15s,color .15s}
@media(hover:hover){.btn:hover{border-color:var(--ink)}.btn.pri:hover{background:var(--led);border-color:var(--led);color:#fff}footer a:hover{color:var(--ink)}}
.btn:disabled{opacity:.45;cursor:default;border-color:var(--rule)}
.btn.pri{background:var(--ink);border-color:var(--ink);color:var(--cream)}
.msg{font:12px var(--mono);color:var(--faint)}.pf-ok{color:var(--ok)}.pf-err{color:var(--bad)}
.chip{display:inline-block;padding:0 8px;border:1px solid var(--rule);border-radius:99px;font:11px/20px var(--mono);color:var(--muted);white-space:nowrap}
.notice{display:block;padding:12px 14px;border:1px solid var(--rule);border-left:3px solid var(--led);border-radius:8px;background:var(--panel);font-size:14px;text-decoration:none}.notice b{font-weight:500;white-space:nowrap}
footer{display:flex;align-items:center;justify-content:space-between;gap:16px;margin-top:40px;border-top:1px solid var(--rule);font:12px var(--mono);color:var(--faint)}
footer a{display:inline-flex;align-items:center;min-height:40px;color:var(--muted);text-decoration:none}
header{display:flex;align-items:baseline;flex-wrap:wrap;gap:4px 12px;margin-bottom:20px}
h1{flex:1;margin:0;font-size:22px;font-weight:600;letter-spacing:-.01em}
.note{margin:8px 0 0;font-size:13px;color:var(--muted)}
.drop{display:flex;flex-direction:column;align-items:center;justify-content:center;gap:4px;min-height:140px;padding:20px;border:1px dashed var(--rule);border-radius:10px;background:var(--panel);text-align:center;cursor:pointer;color:var(--muted);font-size:14px}
.drop.hover{border-color:var(--ink);background:var(--cream)}
/* ── Update ── */
.chip.ok{border-color:var(--ok);color:var(--ok)}.chip.warn{border-color:var(--led);color:var(--ink)}.chip.bad{color:var(--faint)}.chip.err{border-color:var(--bad);color:var(--bad)}
.notice{margin-top:16px}.notice .btn{margin-top:12px}
#handoffFrom{word-break:break-all}
#drop{margin-top:16px;transition:border-color .15s}#drop b{font-weight:500;color:var(--ink)}
/* dim the title, not the reason under it */
#drop.disabled{cursor:default;border-style:solid}#drop.disabled b{opacity:.45}#drop.disabled .msg{color:var(--muted)}
#bar{display:none;height:4px;margin-top:16px;background:var(--ghost)}
#fill{height:100%;width:0;background:var(--led);transition:width .1s linear}
#msg{min-height:20px;margin-top:12px;font-size:14px;color:var(--muted)}#msg.pf-err{color:var(--bad)}
#done{margin-bottom:16px}#doneMsg{margin:0}
.pf-offline #pill{opacity:.45}
</style></head><body>

<main class="wrap">
  <header><h1>Update</h1><span class="chip" id="pill">&hellip;</span></header>
  <p class="note">Drop a firmware .bin: the panel flashes itself over the network and restarts on the new build.</p>

  <!-- The build page hands a firmware URL over via ?src=: the phone never
       touches a file picker. -->
  <div class="notice" id="handoff" hidden>
    <h2>Linked build</h2>
    <div class="msg" id="handoffFrom"></div>
    <button id="handoffGo" class="btn pri" type="button" disabled>Fetch &amp; flash</button>
  </div>

  <div class="notice" id="armHint" hidden>This build needs arming first. On the panel: hold <b>K2</b> &rarr; NETWORK, then turn <b>K4</b> &rarr; <b>UPDATE</b>.</div>

  <div id="drop" class="drop disabled" role="button" tabindex="0" aria-disabled="true">
    <b>Drop a .bin here</b>
    <span class="msg" id="why">Checking the panel&hellip;</span>
  </div>
  <!-- accept="*/*", not ".bin": Android maps unknown extensions to a
       media-only picker (camera/gallery), and on some devices NO accept
       does the same; an explicit any-type accept is what reliably brings
       up the file manager. The JS checks extension and size instead. -->
  <input id="file" type="file" accept="*/*" hidden disabled>
  <div id="bar"><div id="fill"></div></div>
  <div id="msg" aria-live="polite"></div>
  <div class="notice" id="done" hidden><p id="doneMsg"></p><button id="open" class="btn pri" type="button">Open console</button></div>

  <p class="note">No file? <a id="src" href="https://patternflow.work/update">patternflow.work/update</a> sends the
  latest release straight back to this page. Your own arduino-cli export works too. Keep the panel
  powered: it checks, flashes and restarts by itself.</p>

  <footer><a href="/">Console</a><a href="https://patternflow.work" target="_blank" rel="noopener">patternflow.work</a></footer>
</main>

<script>
function $(i){return document.getElementById(i)}
var drop=$('drop'),fileIn=$('file'),pill=$('pill'),bar=$('bar'),fill=$('fill'),msg=$('msg'),go=$('handoffGo');
var st=null,     // the last /update/status
    build=null,  // the image running now, from /api/status
    phase='',    // '' | fetch | upload | wait | lost
    job=null,    // this flash: {from: old build, to: the file's build, v: old version}
    poll=null,last=null;

function setPill(t,c){pill.textContent=t;pill.className='chip '+(c||'')}
function say(t,k){PF.say(t,k||'info',msg)}

// Why no file can go in now ('' = it can): the picker is shut, reason on it.
function why(){
  return phase==='fetch'?'Downloading the build…':phase==='upload'?'Flashing…'
    :phase==='wait'?'Restarting…':phase==='lost'?'Waiting for the panel…'
    :!st?'Checking the panel…':st.busy?'Busy — an update is already running'
    :!st.armed?'Locked — arm it on the panel first (above)':'';
}
function render(){
  var w=why(),s=st;
  if(!phase)setPill(!s?'…':s.busy?'busy':s.armed?'ready':'locked',!s?'':s.busy?'warn':s.armed?'ok':'bad');
  $('armHint').hidden=!(s&&!s.armed&&!s.busy&&!phase);
  drop.classList.toggle('disabled',!!w);
  drop.setAttribute('aria-disabled',w?'true':'false');
  fileIn.disabled=go.disabled=!!w;
  $('why').textContent=w||'or click to choose a file';
}

// One connection at a time: a poll still in flight when the 1.2 MB POST
// opened was enough to fail it. The poll keeps its request (last) so an
// upload can wait for it; PF.hold then keeps the lane quiet.
function status(){
  return last=fetch('/update/status',{cache:'no-store'}).then(function(r){if(!r.ok)throw Error('HTTP '+r.status);return r.json()});
}
function startPoll(){
  if(poll)poll.stop();
  poll=PF.poll(status,2000,function(s){if(s){st=s;render()}});
}

function check(f){
  return !/\.bin$/i.test(f.name)?'That is not a .bin file.'
    :f.size>3*1024*1024?'Too big for the 3 MB app partition. This looks like a merged full-flash image; upload the app .bin instead.'
    :f.size<200*1024?'Suspiciously small for Patternflow firmware. Wrong file?':'';
}

// The file's build: the ELF SHA-256 esptool puts at 0xb0, first four bytes
// (src/core_build.h). All zeros = unstamped, then unknowable here.
function fileBuild(f){
  return new Promise(function(y){
    var r=new FileReader();
    r.onload=function(){var b=new Uint8Array(r.result),h='',i;for(i=0;i<b.length;i++)h+=(b[i]<16?'0':'')+b[i].toString(16);y(h.length===8&&/[^0]/.test(h)?h:null)};
    r.onerror=function(){y(null)};
    r.readAsArrayBuffer(f.slice(176,180));
  });
}

function send(f){
  return new Promise(function(y,n){
    var x=new XMLHttpRequest(),fd=new FormData();
    function no(t){n(Error(t))}
    x.open('POST','/update?size='+f.size);
    x.timeout=300000;
    x.upload.onprogress=function(e){if(e.lengthComputable)fill.style.width=Math.round(e.loaded*100/e.total)+'%'};
    x.onload=function(){
      if(x.status===200)return y();
      var t='upload failed ('+x.status+')';
      try{t=JSON.parse(x.responseText).error||t}catch(e){}
      no('Failed: '+t);
    };
    x.onerror=function(){no('Connection lost during upload. The device still runs its old firmware unless it just rebooted - if in doubt, try again.')};
    x.ontimeout=function(){no('Upload timed out. Try again closer to the access point, or flash over USB.')};
    fd.append('firmware',f,f.name);
    x.send(fd);
  });
}

function upload(f){
  // why() too: the state can change while the picker is open
  var bad=check(f)||why();
  if(bad){say(bad,'err');return}
  job={from:build||PF.v,to:null,v:st&&st.version};
  phase='upload';render();setPill('flashing','warn');
  // the result stays on this page: no version reload
  PF.dirty=true;
  poll.stop();
  $('done').hidden=true;
  bar.style.display='block';fill.style.width='0%';
  say('Uploading '+f.name+' ('+(f.size/1048576).toFixed(2)+' MB). Keep this tab open and the device powered.');
  var p=Promise.all([fileBuild(f),last&&last.catch(function(){})]).then(function(r){job.to=r[0];return send(f)});
  PF.hold(p,{guard:true}).then(restart,function(e){
    phase='';PF.dirty=false;bar.style.display='none';
    say(e.message,'err');startPoll();render();
  });
}

// The panel reboots 1.2 s after answering. The same image again (or an
// unknown old build) has no new build to wait for: wait out the reboot.
function restart(){
  var any=!job.from||job.to===job.from;
  phase='wait';render();setPill('restarting','warn');
  fill.style.width='100%';
  say('Flashed. The panel is restarting on the new build…');
  new Promise(function(y){setTimeout(y,any?4000:0)}).then(function(){
    return PF.waitForDevice({build:any?null:job.from,timeout:120000});
  }).then(done,function(){
    phase='lost';render();setPill('no answer','err');
    say('No answer for two minutes. Patterns back on its screen? Then it has a new address: see the panel (hold K2 → NETWORK) or try http://patternflow.local/. Dark or restarting: flash it over USB at patternflow.work/flash.','err');
  });
}
function done(s){
  $('doneMsg').textContent=(job.to&&job.to===job.from?'Reflashed v':'Updated to v')+s.version
    +(job.v&&job.v!==s.version?' (was v'+job.v+')':'')
    +(s.variant&&s.variant!=='core'?' — '+s.variant+' '+(s.variantVersion||''):'')+'.';
  $('open').onclick=function(){location.replace('/?v='+s.build)};
  $('done').hidden=false;
  bar.style.display='none';say('');
  phase='';startPoll();render();
}

// The running build; and a late answer (the chrome keeps probing).
PF.status(function(s){
  build=s.build;
  // An edition's image comes from its own card; /update on the site sends the standard firmware.
  if(s.variant&&s.variant!=='core'){var a=$('src');a.href='https://patternflow.work/editions#'+encodeURIComponent(s.variant);a.textContent='patternflow.work/editions'}
  if(phase!=='lost')return;
  if(!job.from||s.build!==job.from||job.to===job.from)done(s);
  else{phase='';PF.dirty=false;bar.style.display='none';say('The panel is back, but still on its old build — the update did not take. Try again.','err');startPoll();render()}
});

drop.addEventListener('click',function(){if(!why())fileIn.click()});
drop.addEventListener('keydown',function(e){if(e.key==='Enter'||e.key===' '){e.preventDefault();if(!why())fileIn.click()}});
// cleared, so the same file again still fires
fileIn.addEventListener('change',function(){var f=fileIn.files[0];fileIn.value='';if(f)upload(f)});
['dragover','dragenter'].forEach(function(ev){drop.addEventListener(ev,function(e){e.preventDefault();if(!why())drop.classList.add('hover')})});
['dragleave','drop'].forEach(function(ev){drop.addEventListener(ev,function(e){e.preventDefault();drop.classList.remove('hover')})});
drop.addEventListener('drop',function(e){var f=e.dataTransfer.files[0];if(f&&!why())upload(f)});

// ?src= handoff from the build page ("Send over Wi-Fi"): this page fetches
// the .bin itself and feeds it into the same upload path — no file picker,
// which some Android systems cannot show for arbitrary files. The firmware
// route serves public CORS for exactly this fetch.
var srcUrl=null;
try{
  var s=new URLSearchParams(location.search).get('src');
  if(s&&/^https?:\/\//i.test(s)){
    srcUrl=s;
    $('handoffFrom').textContent=s.replace(/^https?:\/\//i,'');
    $('handoff').hidden=false;
  }
}catch(e){}
go.addEventListener('click',function(){
  if(!srcUrl||why())return;
  phase='fetch';render();setPill('fetching','warn');
  say('Downloading the build from '+srcUrl.split('/')[2]+' ...');
  fetch(srcUrl).then(function(r){
    if(!r.ok)throw new Error('HTTP '+r.status);
    return r.blob();
  }).then(function(b){
    phase='';
    upload(new File([b],'firmware.bin',{type:'application/octet-stream'}));
  },function(e){
    phase='';render();
    say('Could not download the build ('+e.message+'). Download the .bin on this device and drop it below instead.','err');
  });
});

startPoll();render();
</script>
</body></html>
)HTML";
// <gz:WEB_UPDATE_HTML> GENERATED by firmware/toolchain/console_pages.py build — do not edit.
// gzip -9 of WEB_UPDATE_HTML (15240 bytes → 6487 bytes), served with Content-Encoding: gzip.
const uint8_t WEB_UPDATE_HTML_GZ[] PROGMEM = {
  0x1f,0x8b,0x08,0x00,0x00,0x00,0x00,0x00,0x02,0xff,0xad,0x5b,0xe9,0x72,0xdb,0x48,
  0x92,0xfe,0xaf,0xa7,0x28,0xd1,0x33,0x02,0xd0,0x06,0x41,0x52,0xb6,0x6c,0x19,0x14,
  0xa4,0x95,0x75,0x74,0xf7,0xf8,0x0c,0xcb,0xde,0xde,0x6d,0x8f,0x67,0x02,0x24,0x0a,
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  0x7d,0xe7,0xd9,0x88,0x3b,0x00,0x00,
};
constexpr size_t WEB_UPDATE_HTML_GZ_LEN = sizeof(WEB_UPDATE_HTML_GZ);
// </gz:WEB_UPDATE_HTML>
